## CMakeLists.txt
```
# Copyright (C) 2026 Intel Corporation.  All rights reserved.
# SPDX-License-Identifier: Apache-2.0 WITH LLVM-exception

cmake_minimum_required(VERSION 3.20.0)
find_package(Zephyr REQUIRED HINTS $ENV{ZEPHYR_BASE})
project(wamr_platform_api_tests)
if(CONFIG_WAMR_TEST_MUTEX_ONLY)
  target_sources(app PRIVATE src/test_mutex_only.c)
else()
  target_sources(app PRIVATE src/test_common.c src/test_memory.c src/test_sync.c
                             src/test_thread.c src/test_time.c)
endif()
```

## Kconfig
```
# Copyright (C) 2026 Intel Corporation.  All rights reserved.
# SPDX-License-Identifier: Apache-2.0 WITH LLVM-exception

mainmenu "WAMR Zephyr platform API tests"
source "Kconfig.zephyr"

config WAMR_TEST_USER_MODE
    bool "Run applicable WAMR tests as user threads"
    default n

config WAMR_TEST_MUTEX_ONLY
    bool "Exercise a mutex-only synchronization pool in a fresh image"
    depends on WAMR_TEST_USER_MODE
```

## prj.conf
```kconfig
# Copyright (C) 2026 Intel Corporation.  All rights reserved.
# SPDX-License-Identifier: Apache-2.0 WITH LLVM-exception

CONFIG_ZTEST=y
CONFIG_PRINTK=y
CONFIG_ASSERT=y
CONFIG_THREAD_RUNTIME_STATS=y
CONFIG_WAMR=y
CONFIG_WAMR_INTERP=y
CONFIG_WAMR_AOT=n
CONFIG_WAMR_LIBC_BUILTIN=y
CONFIG_WAMR_GLOBAL_HEAP_POOL=y
CONFIG_WAMR_GLOBAL_HEAP_SIZE=131072
```

## src/test_common.c
```c
/*
 * Copyright (C) 2026 Intel Corporation.  All rights reserved.
 * SPDX-License-Identifier: Apache-2.0 WITH LLVM-exception
 */

#include <zephyr/kernel.h>

#include "test_common.h"
#include "platform_api_vmcore.h"
#include "zephyr_thread_pool.h"

WAMR_ZEPHYR_THREAD_POOL_DEFINE(wamr_test_threads, WAMR_TEST_THREAD_COUNT,
                               WAMR_TEST_THREAD_STACK_SIZE);
WAMR_ZEPHYR_THREAD_POOL_DEFINE(wamr_replacement_threads, 1,
                               WAMR_TEST_THREAD_STACK_SIZE);
static ZTEST_BMEM uint8_t test_pool[TEST_POOL_SIZE] __aligned(8);
static k_tid_t thread_pool_test_owner;

#define UNMAPPED_SELF_THREAD_STACK_SIZE 1024U

static struct k_thread unmapped_self_thread;
K_THREAD_STACK_DEFINE(unmapped_self_thread_stack,
                      UNMAPPED_SELF_THREAD_STACK_SIZE);

static void
record_unmapped_self(void *arg1, void *arg2, void *arg3)
{
    korp_tid *result = arg1;

    ARG_UNUSED(arg2);
    ARG_UNUSED(arg3);
    *result = os_self_thread();
}

static int
run_unmapped_self_thread(korp_tid *result)
{
    k_tid_t tid;

    *result = NULL;
    tid = k_thread_create(&unmapped_self_thread, unmapped_self_thread_stack,
                          K_THREAD_STACK_SIZEOF(unmapped_self_thread_stack),
                          record_unmapped_self, result, NULL, NULL, 5, 0,
                          K_NO_WAIT);
    if (tid == NULL) {
        return BHT_ERROR;
    }
    return k_thread_join(tid, K_SECONDS(1)) == 0 ? BHT_OK : BHT_ERROR;
}

int
wamr_test_thread_pool_prepare(void)
{
#if defined(CONFIG_USERSPACE)
    static bool bounds_checked;

    if (!bounds_checked) {
        wamr_zephyr_thread_pool_t oversized = wamr_test_threads;

        /* Run before the first binding: replacement rejection must not hide
         * acceptance of a capacity claim larger than this registered stack.
         * Count one keeps every supplied object address genuine.
         */
        oversized.thread_count = 1U;
        oversized.stack_size = 1024U * 1024U;
        oversized.stack_stride = oversized.stack_size;
        zassert_equal(
            wamr_zephyr_thread_pool_prepare(&oversized, thread_pool_test_owner),
            BHT_ERROR, "oversized registered stack was accepted");

        oversized.stack_size = wamr_test_threads.stack_size;
        oversized.stack_stride = 1024U * 1024U;
        zassert_equal(
            wamr_zephyr_thread_pool_prepare(&oversized, thread_pool_test_owner),
            BHT_ERROR, "incorrect registered stack stride was accepted");
        bounds_checked = true;
    }
#endif
    return wamr_zephyr_thread_pool_prepare(&wamr_test_threads,
                                           thread_pool_test_owner);
}

void *
wamr_test_thread_pool_setup(void)
{
    /* Suite setup runs on the persistent Ztest runner; individual case threads
     * are recreated and inherit the runner's object permissions.
     */
    if (thread_pool_test_owner == NULL) {
        thread_pool_test_owner = k_current_get();
    }
    zassert_equal(thread_pool_test_owner, k_current_get(),
                  "pool owner must stay alive across suites");
    zassert_equal(wamr_test_thread_pool_prepare(), BHT_OK,
                  "stable-owner thread pool setup failed");
    return NULL;
}

static bool
init_test_runtime(void)
{
    RuntimeInitArgs args = { 0 };

    memset(test_pool, 0xA5, sizeof(test_pool));
    args.mem_alloc_type = Alloc_With_Pool;
    args.mem_alloc_option.pool.heap_buf = test_pool;
    args.mem_alloc_option.pool.heap_size = sizeof(test_pool);
    return wasm_runtime_full_init(&args);
}

void
pool_before(void *fixture)
{
    ARG_UNUSED(fixture);
    zassert_equal(wamr_test_thread_pool_prepare(), BHT_OK,
                  "thread pool preparation failed");
    zassert_true(init_test_runtime(), "pool init failed");
}

void
pool_after(void *fixture)
{
    ARG_UNUSED(fixture);
    wasm_runtime_destroy();
}

ZTEST_SUITE(platform_thread_pool, NULL, wamr_test_thread_pool_setup, NULL, NULL,
            NULL);

ZTEST(platform_thread_pool, test_prepare_validates_and_preserves_pool)
{
    wamr_zephyr_thread_pool_t malformed = wamr_test_threads;

    zassert_equal(wamr_zephyr_thread_pool_prepare(NULL, k_current_get()),
                  BHT_ERROR, "null pool was accepted");
    zassert_equal(wamr_zephyr_thread_pool_prepare(&wamr_test_threads, NULL),
                  BHT_ERROR, "null target was accepted");

    malformed.thread_count = 0U;
    zassert_equal(wamr_zephyr_thread_pool_prepare(&malformed, k_current_get()),
                  BHT_ERROR, "empty pool was accepted");

    malformed = wamr_test_threads;
    malformed.stack_size = 0U;
    zassert_equal(wamr_zephyr_thread_pool_prepare(&malformed, k_current_get()),
                  BHT_ERROR, "zero-sized stack was accepted");

    zassert_equal(wamr_test_thread_pool_prepare(), BHT_OK,
                  "initial pool preparation failed");
    zassert_equal(wamr_test_thread_pool_prepare(), BHT_OK,
                  "identical pool preparation failed");
    zassert_equal(wamr_zephyr_thread_pool_prepare(&wamr_replacement_threads,
                                                  thread_pool_test_owner),
                  BHT_ERROR, "active pool was replaced");

    zassert_true(init_test_runtime(),
                 "runtime initialization after pool preparation failed");
    wasm_runtime_destroy();
}

ZTEST(platform_thread_pool,
      test_self_thread_rejects_preinit_and_unmapped_callers)
{
    korp_tid preinit_identity = os_self_thread();
    korp_tid unmapped_identity = NULL;
    korp_tid destroyed_identity;
    int unmapped_result = BHT_ERROR;
    bool runtime_initialized;

    zassert_equal(wamr_test_thread_pool_prepare(), BHT_OK,
                  "thread pool preparation failed");
    runtime_initialized = init_test_runtime();
    if (runtime_initialized) {
        unmapped_result = run_unmapped_self_thread(&unmapped_identity);
        wasm_runtime_destroy();
    }
    destroyed_identity = os_self_thread();

    zassert_true(runtime_initialized, "runtime initialization failed");
    zassert_equal(unmapped_result, BHT_OK,
                  "unmapped Zephyr thread did not complete");
    zassert_is_null(preinit_identity,
                    "pre-init caller received a native thread identity");
    zassert_is_null(unmapped_identity,
                    "unmapped caller received a native thread identity");
    zassert_is_null(destroyed_identity,
                    "post-destroy caller received a native thread identity");
}
```

## src/test_common.h
```c
/*
 * Copyright (C) 2026 Intel Corporation.  All rights reserved.
 * SPDX-License-Identifier: Apache-2.0 WITH LLVM-exception
 */

#ifndef WAMR_ZEPHYR_PLATFORM_API_TEST_COMMON_H
#define WAMR_ZEPHYR_PLATFORM_API_TEST_COMMON_H

#include <stddef.h>
#include <stdint.h>
#include <string.h>

#include <zephyr/kernel.h>
#include <zephyr/ztest.h>

#include "platform_api_extension.h"
#include "wasm_export.h"

#define TEST_POOL_SIZE (128U * 1024U)
#define WAMR_TEST_THREAD_COUNT 4U
#define WAMR_TEST_THREAD_STACK_SIZE 2048U

int
wamr_test_thread_pool_prepare(void);
void *
wamr_test_thread_pool_setup(void);
int
wamr_test_sync_pool_prepare(void);
void
pool_before(void *fixture);
void
pool_after(void *fixture);
struct k_mutex *
wamr_test_sync_mutex(void);
struct k_condvar *
wamr_test_sync_condvar(void);

#if defined(CONFIG_WAMR_TEST_USER_MODE)
#define WAMR_CONTEXT_TEST(suite, name) ZTEST_USER(suite, name)
#define WAMR_CONTEXT_TEST_F(suite, name) ZTEST_USER_F(suite, name)
#else
#define WAMR_CONTEXT_TEST(suite, name) ZTEST(suite, name)
#define WAMR_CONTEXT_TEST_F(suite, name) ZTEST_F(suite, name)
#endif

#endif /* WAMR_ZEPHYR_PLATFORM_API_TEST_COMMON_H */
```

## src/test_memory.c
```c
/*
 * Copyright (C) 2026 Intel Corporation.  All rights reserved.
 * SPDX-License-Identifier: Apache-2.0 WITH LLVM-exception
 */

#include "test_common.h"

ZTEST_SUITE(pool_memory, NULL, wamr_test_thread_pool_setup, pool_before,
            pool_after, NULL);

ZTEST(pool_memory, test_allocate_write_free_and_reuse)
{
    uint8_t *ptr = wasm_runtime_malloc(64U);
    uint8_t *reused;

    zassert_not_null(ptr, "initial allocation failed");
    memset(ptr, 0xA5, 64U);
    for (size_t i = 0; i < 64U; ++i) {
        zassert_equal(ptr[i], 0xA5, "allocated block is not writable");
    }

    wasm_runtime_free(ptr);
    reused = wasm_runtime_malloc(64U);
    zassert_not_null(reused, "freed storage was not reusable");
    memset(reused, 0x5A, 64U);
    for (size_t i = 0; i < 64U; ++i) {
        zassert_equal(reused[i], 0x5A, "reused block is not writable");
    }
    wasm_runtime_free(reused);
}

ZTEST(pool_memory, test_realloc_preserves_existing_bytes)
{
    uint8_t *ptr = wasm_runtime_malloc(64U);

    zassert_not_null(ptr, "initial allocation failed");
    for (size_t i = 0; i < 64U; ++i) {
        ptr[i] = (uint8_t)i;
    }

    ptr = wasm_runtime_realloc(ptr, 128U);
    zassert_not_null(ptr, "reallocation failed");
    for (size_t i = 0; i < 64U; ++i) {
        zassert_equal(ptr[i], (uint8_t)i, "existing byte was not preserved");
    }
    wasm_runtime_free(ptr);
}

ZTEST(pool_memory, test_multiple_allocations_do_not_overlap)
{
    uint8_t *first = wasm_runtime_malloc(64U);
    uint8_t *second = wasm_runtime_malloc(64U);

    zassert_not_null(first, "first allocation failed");
    zassert_not_null(second, "second allocation failed");
    zassert_true((uintptr_t)first + 64U <= (uintptr_t)second
                     || (uintptr_t)second + 64U <= (uintptr_t)first,
                 "allocations overlap");
    memset(first, 0xA5, 64U);
    memset(second, 0x5A, 64U);
    for (size_t i = 0; i < 64U; ++i) {
        zassert_equal(first[i], 0xA5, "first allocation was overwritten");
        zassert_equal(second[i], 0x5A, "second allocation was overwritten");
    }
    wasm_runtime_free(first);
    wasm_runtime_free(second);
}

ZTEST(pool_memory, test_aligned_alloc_returns_aligned_writable_block)
{
    void *ptr = wasm_runtime_aligned_alloc(64U, 32U);
    zassert_not_null(ptr, "32-byte aligned allocation failed");
    zassert_equal((uintptr_t)ptr % 32U, 0U, "incorrect alignment");
    memset(ptr, 0x5A, 64U);
    for (size_t i = 0; i < 64U; ++i) {
        zassert_equal(((uint8_t *)ptr)[i], 0x5A, "block is not writable");
    }
    wasm_runtime_free(ptr);
    zassert_not_null(wasm_runtime_aligned_alloc(64U, 32U),
                     "freed aligned storage was not reusable");
}

ZTEST(pool_memory, test_pool_exhaustion_returns_null)
{
    void *blocks[TEST_POOL_SIZE / 1024U];
    size_t count = 0;

    while (count < ARRAY_SIZE(blocks)) {
        blocks[count] = wasm_runtime_malloc(1024U);
        if (blocks[count] == NULL) {
            break;
        }
        count++;
    }

    zassert_true(count > 0U, "no pool allocations succeeded");
    zassert_true(count < ARRAY_SIZE(blocks),
                 "pointer array filled before pool exhaustion");
    while (count > 0U) {
        wasm_runtime_free(blocks[--count]);
    }
    zassert_not_null(wasm_runtime_malloc(1024U),
                     "pool did not recover after exhaustion");
}

ZTEST(pool_memory, test_aligned_alloc_rejects_invalid_alignment)
{
    zassert_is_null(wasm_runtime_aligned_alloc(64U, 3U),
                    "non-power-of-two alignment accepted");
}

ZTEST(pool_memory, test_aligned_alloc_rejects_invalid_size)
{
    zassert_is_null(wasm_runtime_aligned_alloc(63U, 32U),
                    "size not divisible by alignment accepted");
}

ZTEST(pool_memory, test_pool_recovers_after_fragmentation)
{
    void *first = wasm_runtime_malloc(32U * 1024U);
    void *middle = wasm_runtime_malloc(32U * 1024U);
    void *last = wasm_runtime_malloc(32U * 1024U);
    void *larger;

    zassert_not_null(first, "first allocation failed");
    zassert_not_null(middle, "middle allocation failed");
    zassert_not_null(last, "last allocation failed");
    wasm_runtime_free(middle);
    wasm_runtime_free(first);
    wasm_runtime_free(last);

    larger = wasm_runtime_malloc(64U * 1024U);
    zassert_not_null(larger, "pool did not coalesce fragmented blocks");
    wasm_runtime_free(larger);
}
```

## src/test_mutex_only.c
```c
/*
 * Copyright (C) 2026 Intel Corporation.  All rights reserved.
 * SPDX-License-Identifier: Apache-2.0 WITH LLVM-exception
 */

#include <zephyr/kernel.h>
#include <zephyr/ztest.h>

#include "platform_api_extension.h"
#include "zephyr_sync_pool.h"

WAMR_ZEPHYR_SYNC_POOL_DEFINE(mutex_only_pool, 2, 0);
static struct k_condvar unused_condvar;

static void *
mutex_only_setup(void)
{
    wamr_zephyr_sync_pool_t malformed = mutex_only_pool;

    /* Run before binding so replacement rejection cannot hide bad validation.
     */
    malformed.condvar_count = 1;
    zassert_equal(wamr_zephyr_sync_pool_prepare(&malformed, k_current_get()),
                  BHT_ERROR, "NULL condition storage with positive count");
    malformed = mutex_only_pool;
    malformed.condvars = &unused_condvar;
    zassert_equal(wamr_zephyr_sync_pool_prepare(&malformed, k_current_get()),
                  BHT_ERROR, "condition storage with zero count");
    zassert_equal(
        wamr_zephyr_sync_pool_prepare(&mutex_only_pool, k_current_get()),
        BHT_OK, "mutex-only pool preparation failed");
    zassert_equal(
        wamr_zephyr_sync_pool_prepare(&mutex_only_pool, k_current_get()),
        BHT_OK, "identical mutex-only preparation failed");
    return NULL;
}

ZTEST_SUITE(platform_mutex_only, NULL, mutex_only_setup, NULL, NULL, NULL);

ZTEST_USER(platform_mutex_only, test_capacity_and_recovery)
{
    korp_mutex mutexes[3] = { 0 };
    korp_cond cond = NULL;
    int results[3];
    int cond_result = os_cond_init(&cond);
    int lock_result = BHT_ERROR;
    int unlock_result = BHT_ERROR;
    int destroy_results[3] = { BHT_ERROR, BHT_ERROR, BHT_ERROR };
    int recovery_result;
    int recovery_destroy_result = BHT_ERROR;

    for (size_t i = 0; i < ARRAY_SIZE(mutexes); i++) {
        results[i] = os_mutex_init(&mutexes[i]);
    }
    if (results[0] == BHT_OK) {
        lock_result = os_mutex_lock(&mutexes[0]);
        if (lock_result == BHT_OK) {
            unlock_result = os_mutex_unlock(&mutexes[0]);
        }
    }
    for (size_t i = 0; i < ARRAY_SIZE(mutexes); i++) {
        if (results[i] == BHT_OK) {
            destroy_results[i] = os_mutex_destroy(&mutexes[i]);
        }
    }
    if (cond_result == BHT_OK) {
        os_cond_destroy(&cond);
    }
    recovery_result = os_mutex_init(&mutexes[0]);
    if (recovery_result == BHT_OK) {
        recovery_destroy_result = os_mutex_destroy(&mutexes[0]);
    }

    zassert_equal(cond_result, BHT_ERROR, "zero-CV pool allocated a condition");
    zassert_equal(results[0], BHT_OK, "first mutex allocation failed");
    zassert_equal(results[1], BHT_OK, "second mutex allocation failed");
    zassert_equal(results[2], BHT_ERROR, "mutex pool capacity was exceeded");
    zassert_equal(lock_result, BHT_OK, "user mutex lock failed");
    zassert_equal(unlock_result, BHT_OK, "user mutex unlock failed");
    zassert_equal(destroy_results[0], BHT_OK, "first mutex destruction failed");
    zassert_equal(destroy_results[1], BHT_OK,
                  "second mutex destruction failed");
    zassert_equal(recovery_result, BHT_OK, "mutex capacity did not recover");
    zassert_equal(recovery_destroy_result, BHT_OK, "recovered mutex leaked");
}
```

## src/test_time.c
```c
/*
 * Copyright (C) 2026 Intel Corporation.  All rights reserved.
 * SPDX-License-Identifier: Apache-2.0 WITH LLVM-exception
 */

#include <zephyr/kernel.h>

#include "test_common.h"

#include "platform_api_vmcore.h"

#define MIN_SLEEP_ELAPSED_US 10000ULL
#define MAX_ELAPSED_US 500000ULL
#define MAX_SLEEP_CPU_US 10000ULL
#define BUSY_WORK_ITERATIONS 20000000U

struct platform_time_fixture {
    uint64 first;
    uint64 second;
};

ZTEST_DMEM static struct platform_time_fixture time_results = { 0 };

static uint64
one_tick_us(void)
{
    return k_ticks_to_us_floor64(1) + 1U;
}

static void
busy_work(void)
{
    volatile uint32_t value = 0;

    for (uint32_t i = 0; i < BUSY_WORK_ITERATIONS; ++i) {
        value += i;
    }
    ARG_UNUSED(value);
}

static void
assert_cpu_time_available(void)
{
#ifndef CONFIG_THREAD_RUNTIME_STATS
    ztest_test_skip();
#endif
#if defined(CONFIG_WAMR_TEST_USER_MODE) && defined(CONFIG_ARC)
    /* FIXME: Zephyr 3.7 k_thread_runtime_stats_get() calls privileged
     * arch_irq_lock() from qemu_arc user threads. */
    ztest_test_skip();
#endif
}

static void *
time_setup(void)
{
    wamr_test_thread_pool_setup();
    return &time_results;
}

static void
time_before(void *fixture)
{
    struct platform_time_fixture *results = fixture;

    results->first = 0U;
    results->second = 0U;
    pool_before(fixture);
}

ZTEST_SUITE(platform_time, NULL, time_setup, time_before, pool_after, NULL);

WAMR_CONTEXT_TEST_F(platform_time, test_boot_time_is_nondecreasing)
{
    fixture->first = os_time_get_boot_us();
    fixture->second = os_time_get_boot_us();

    zassert_true(fixture->second >= fixture->first, "boot time regressed");
}

WAMR_CONTEXT_TEST_F(platform_time, test_boot_time_advances_with_kernel_sleep)
{
    fixture->first = os_time_get_boot_us();

    k_sleep(K_MSEC(20));
    fixture->second = os_time_get_boot_us() - fixture->first;
    zassert_true(fixture->second >= MIN_SLEEP_ELAPSED_US,
                 "kernel sleep advanced boot time too little: %llu us",
                 fixture->second);
    zassert_true(fixture->second <= MAX_ELAPSED_US,
                 "kernel sleep advanced boot time too much: %llu us",
                 fixture->second);
}

WAMR_CONTEXT_TEST_F(platform_time, test_boot_time_matches_zephyr_uptime_units)
{
    fixture->first = (uint64)k_uptime_get() * 1000ULL;
    fixture->second = os_time_get_boot_us();
    fixture->second = fixture->second >= fixture->first
                          ? fixture->second - fixture->first
                          : fixture->first - fixture->second;

    zassert_true(fixture->second <= one_tick_us(),
                 "boot time differs from Zephyr uptime by %llu us",
                 fixture->second);
}

WAMR_CONTEXT_TEST_F(platform_time, test_repeated_boot_time_reads_do_not_regress)
{
    fixture->first = os_time_get_boot_us();

    for (size_t i = 0; i < 64U; ++i) {
        fixture->second = os_time_get_boot_us();

        zassert_true(fixture->second >= fixture->first,
                     "boot time regressed at read %zu", i);
        fixture->first = fixture->second;
    }
}

WAMR_CONTEXT_TEST_F(platform_time, test_thread_cpu_time_is_nondecreasing)
{
    assert_cpu_time_available();
    fixture->first = os_time_thread_cputime_us();
    for (size_t i = 0; i < 64U; ++i) {
        fixture->second = os_time_thread_cputime_us();

        zassert_true(fixture->second >= fixture->first,
                     "CPU time regressed at read %zu", i);
        fixture->first = fixture->second;
    }
}

WAMR_CONTEXT_TEST_F(platform_time, test_cpu_time_increases_during_busy_work)
{
#if defined(CONFIG_ARCH_POSIX)
    /* FIXME: native_sim's CONFIG_THREAD_RUNTIME_STATS execution cycle counter
     * does not advance for the current thread's busy work. */
    ztest_test_skip();
#endif
    assert_cpu_time_available();
    fixture->first = os_time_thread_cputime_us();
    busy_work();
    fixture->second = os_time_thread_cputime_us();
    zassert_true(fixture->second > fixture->first,
                 "CPU time did not advance during work");
}

WAMR_CONTEXT_TEST_F(platform_time, test_cpu_time_excludes_most_sleep_time)
{
    uint64 boot_before;
    uint64 boot_elapsed;

    assert_cpu_time_available();
    boot_before = os_time_get_boot_us();
    fixture->first = os_time_thread_cputime_us();
    k_sleep(K_MSEC(20));
    boot_elapsed = os_time_get_boot_us() - boot_before;
    fixture->second = os_time_thread_cputime_us();
    zassert_true(boot_elapsed >= MIN_SLEEP_ELAPSED_US,
                 "kernel sleep was shorter than %llu us", MIN_SLEEP_ELAPSED_US);
    zassert_true(boot_elapsed <= MAX_ELAPSED_US,
                 "kernel sleep exceeded %llu us", MAX_ELAPSED_US);
    zassert_true(fixture->second >= fixture->first,
                 "CPU time regressed while sleeping");
    zassert_true(fixture->second - fixture->first <= MAX_SLEEP_CPU_US,
                 "sleep consumed too much CPU time: %llu us",
                 fixture->second - fixture->first);
}

WAMR_CONTEXT_TEST_F(platform_time, test_time_conversion_boundary_is_monotonic)
{
    fixture->first = os_time_get_boot_us();

    k_sleep(K_MSEC(20));
    fixture->second = os_time_get_boot_us();
    zassert_true(fixture->second >= fixture->first,
                 "boot time regressed across a tick");
    zassert_true(fixture->second - fixture->first >= MIN_SLEEP_ELAPSED_US,
                 "conversion did not advance across a tick");
    zassert_true(fixture->second - fixture->first <= MAX_ELAPSED_US,
                 "conversion advanced too far across a tick");
}
```
