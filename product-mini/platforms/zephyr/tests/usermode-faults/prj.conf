## CMakeLists.txt
```
# Copyright (C) 2026 Intel Corporation.  All rights reserved.
# SPDX-License-Identifier: Apache-2.0 WITH LLVM-exception

cmake_minimum_required(VERSION 3.20.0)

find_package(Zephyr REQUIRED HINTS $ENV{ZEPHYR_BASE})
project(wamr_usermode_fault_tests)

target_include_directories(app PRIVATE src ../common)
target_sources(app PRIVATE
               ../common/runtime_user_workflow.c
               src/expected_fault.c
               src/fault_fixture.c
               src/test_guest_boundaries.c
               src/test_harness.c
               src/test_wamr_domain.c)
```

## Kconfig
```
# Copyright (C) 2026 Intel Corporation.  All rights reserved.
# SPDX-License-Identifier: Apache-2.0 WITH LLVM-exception

mainmenu "WAMR Zephyr user-mode fault tests"

config WAMR_TEST_USERMODE_FAULTS
    bool "Exercise WAMR user-mode fault boundaries"
    default n

if WAMR_TEST_USERMODE_FAULTS

choice WAMR_TEST_USERMODE_FAULT_CASE
    prompt "WAMR user-mode fault case"
    default WAMR_TEST_USERMODE_FAULT_SUPERVISOR_RUNTIME_STATE

config WAMR_TEST_USERMODE_FAULT_SUPERVISOR_RUNTIME_STATE
    bool "User cannot access supervisor runtime state"

config WAMR_TEST_USERMODE_FAULT_POOL_PARTITION
    bool "WAMR pool partition is required"

config WAMR_TEST_USERMODE_FAULT_MODULE_PARTITION
    bool "Writable module partition is required"

config WAMR_TEST_USERMODE_FAULT_WAMR_GLOBALS_PARTITION
    bool "WAMR globals partition is required"

config WAMR_TEST_USERMODE_FAULT_WASM_OOB
    bool "Wasm out-of-bounds is a runtime trap"

endchoice

endif # WAMR_TEST_USERMODE_FAULTS

source "Kconfig.zephyr"
```

## prj.conf
```kconfig
# Copyright (C) 2026 Intel Corporation.  All rights reserved.
# SPDX-License-Identifier: Apache-2.0 WITH LLVM-exception

CONFIG_ZTEST=y
CONFIG_PRINTK=y
CONFIG_ASSERT=y
CONFIG_USERSPACE=y
CONFIG_ZTEST_STACK_SIZE=8192

CONFIG_WAMR=y
CONFIG_WAMR_INTERP=y
CONFIG_WAMR_AOT=n
CONFIG_WAMR_LIBC_BUILTIN=y
CONFIG_WAMR_GLOBAL_HEAP_POOL=y
CONFIG_WAMR_GLOBAL_HEAP_SIZE=40960
CONFIG_WAMR_USERSPACE_PARTITION="wamr_partition"
```

## src/expected_fault.c
```c
/*
 * Copyright (C) 2026 Intel Corporation.  All rights reserved.
 * SPDX-License-Identifier: Apache-2.0 WITH LLVM-exception
 */

#include <zephyr/fatal.h>
#include <zephyr/kernel.h>
#include <zephyr/sys/atomic.h>

#include "expected_fault.h"

struct expected_fault_state {
    atomic_t armed;
    atomic_t observed;
    k_tid_t expected_tid;
    unsigned int expected_reason;
    struct k_sem *done;
};

static struct expected_fault_state expected_fault;

void
expected_fault_arm(k_tid_t tid, unsigned int reason, struct k_sem *done)
{
    atomic_clear(&expected_fault.observed);
    expected_fault.expected_tid = tid;
    expected_fault.expected_reason = reason;
    expected_fault.done = done;
    atomic_set(&expected_fault.armed, 1);
}

struct expected_fault_snapshot
expected_fault_snapshot(void)
{
    return (struct expected_fault_snapshot){
        .armed = atomic_get(&expected_fault.armed) != 0,
        .observed = atomic_get(&expected_fault.observed) != 0,
        .expected_tid = expected_fault.expected_tid,
        .expected_reason = expected_fault.expected_reason,
    };
}

void
expected_fault_disarm(void)
{
    atomic_clear(&expected_fault.armed);
    expected_fault.expected_tid = NULL;
    expected_fault.expected_reason = 0U;
    expected_fault.done = NULL;
    atomic_clear(&expected_fault.observed);
}

void
k_sys_fatal_error_handler(unsigned int reason, const struct arch_esf *esf)
{
    ARG_UNUSED(esf);

    if (reason == K_ERR_KERNEL_PANIC || !atomic_get(&expected_fault.armed)
        || atomic_get(&expected_fault.observed)
        || k_current_get() != expected_fault.expected_tid
        || reason != expected_fault.expected_reason
        || expected_fault.done == NULL
        || !atomic_cas(&expected_fault.observed, 0, 1)) {
        k_fatal_halt(reason);
    }

    k_sem_give(expected_fault.done);
}
```

## src/expected_fault.h
```c
/*
 * Copyright (C) 2026 Intel Corporation.  All rights reserved.
 * SPDX-License-Identifier: Apache-2.0 WITH LLVM-exception
 */

#ifndef WAMR_ZEPHYR_TEST_EXPECTED_FAULT_H
#define WAMR_ZEPHYR_TEST_EXPECTED_FAULT_H

#include <stdbool.h>

#include <zephyr/kernel.h>

struct expected_fault_snapshot {
    bool armed;
    bool observed;
    k_tid_t expected_tid;
    unsigned int expected_reason;
};

void
expected_fault_arm(k_tid_t tid, unsigned int reason, struct k_sem *done);
struct expected_fault_snapshot
expected_fault_snapshot(void);
void
expected_fault_disarm(void);

#endif
```

## src/fault_fixture.c
```c
/*
 * Copyright (C) 2026 Intel Corporation.  All rights reserved.
 * SPDX-License-Identifier: Apache-2.0 WITH LLVM-exception
 */

#include <string.h>

#include <zephyr/app_memory/app_memdomain.h>
#include <zephyr/fatal.h>
#include <zephyr/kernel.h>
#include <zephyr/ztest.h>

#include "expected_fault.h"
#include "fault_fixture.h"
#include "wasm_fixtures.h"
#include "zephyr_sync_pool.h"

#define FAULT_WORKER_STACK_SIZE 8192U
#define FAULT_WORKER_PRIORITY 5
#define FAULT_WORKER_TIMEOUT K_SECONDS(1)

struct fault_worker_context {
    struct wamr_fault_results *results;
    wamr_fault_worker_t worker;
};

extern struct k_mem_partition z_libc_partition;

K_APPMEM_PARTITION_DEFINE(wamr_partition);
K_APPMEM_PARTITION_DEFINE(wamr_fault_pool_partition);
K_APPMEM_PARTITION_DEFINE(wamr_fault_module_partition);
K_APPMEM_PARTITION_DEFINE(wamr_fault_results_partition);

static struct k_mem_domain wamr_fault_complete_domain;
static struct k_mem_domain wamr_fault_complete_minus_pool_domain;
static struct k_mem_domain wamr_fault_complete_minus_module_domain;
static struct k_mem_domain wamr_fault_complete_minus_wamr_globals_domain;
static struct k_thread fault_worker_thread;
K_THREAD_STACK_DEFINE(fault_worker_stack, FAULT_WORKER_STACK_SIZE);
static struct k_sem fault_worker_done;
static bool fault_sync_pool_prepared;
static unsigned int fault_sync_pool_prepare_count;
WAMR_ZEPHYR_SYNC_POOL_DEFINE(fault_sync, 16, 8);

static struct k_mem_partition *wamr_fault_complete_partitions[] = {
    &wamr_partition,
    &wamr_fault_pool_partition,
    &wamr_fault_module_partition,
    &z_libc_partition,
    &wamr_fault_results_partition,
};
static struct k_mem_partition *wamr_fault_complete_minus_pool_partitions[] = {
    &wamr_partition,
    &wamr_fault_module_partition,
    &z_libc_partition,
    &wamr_fault_results_partition,
};
static struct k_mem_partition *wamr_fault_complete_minus_module_partitions[] = {
    &wamr_partition,
    &wamr_fault_pool_partition,
    &z_libc_partition,
    &wamr_fault_results_partition,
};
static struct k_mem_partition
    *wamr_fault_complete_minus_wamr_globals_partitions[] = {
        &wamr_fault_pool_partition,
        &wamr_fault_module_partition,
        &z_libc_partition,
        &wamr_fault_results_partition,
    };

K_APP_BMEM(wamr_fault_pool_partition)
static uint8_t fault_pool[WAMR_TEST_RUNTIME_POOL_SIZE] __aligned(8);
K_APP_BMEM(wamr_partition)
static struct wamr_test_runtime workflow_runtime;
K_APP_BMEM(wamr_fault_module_partition)
static uint8_t mutable_module[sizeof(wasm_add)] __aligned(8);
K_APP_BMEM(wamr_fault_results_partition)
static struct wamr_fault_results fault_results;
ZTEST_DMEM static struct wamr_usermode_faults_fixture fault_fixture;
K_APP_BMEM(wamr_fault_results_partition)
static struct fault_worker_context fault_worker_context;

static void
fault_worker_trampoline(void *arg1, void *arg2, void *arg3)
{
    struct fault_worker_context *context = arg1;

    ARG_UNUSED(arg2);
    ARG_UNUSED(arg3);
    context->results->worker_was_user = k_is_user_context();
    context->worker(context->results);
    context->results->worker_completed = true;
    k_sem_give(&fault_worker_done);
}

static struct k_mem_domain *
fault_domain_for_parts(enum wamr_fault_domain_parts parts)
{
    switch (parts) {
        case WAMR_FAULT_COMPLETE_DOMAIN:
            return &wamr_fault_complete_domain;
        case WAMR_FAULT_COMPLETE_DOMAIN & ~WAMR_FAULT_PART_POOL:
            return &wamr_fault_complete_minus_pool_domain;
        case WAMR_FAULT_COMPLETE_DOMAIN & ~WAMR_FAULT_PART_MODULE:
            return &wamr_fault_complete_minus_module_domain;
        case WAMR_FAULT_COMPLETE_DOMAIN & ~WAMR_FAULT_PART_WAMR:
            return &wamr_fault_complete_minus_wamr_globals_domain;
        default:
            zassert_true(false, "unsupported WAMR fault domain mask 0x%x",
                         parts);
            return NULL;
    }
}

static void
fault_worker_grant_sync_pool(k_tid_t tid)
{
    size_t i;

    k_object_access_grant(fault_sync.management_lock, tid);
    for (i = 0; i < fault_sync.mutex_count; i++) {
        k_object_access_grant(&fault_sync.mutexes[i], tid);
    }
    for (i = 0; i < fault_sync.condvar_count; i++) {
        k_object_access_grant(&fault_sync.condvars[i], tid);
    }
}

static k_tid_t
fault_worker_create(enum wamr_fault_domain_parts parts,
                    wamr_fault_worker_t worker)
{
    k_tid_t tid;
    struct k_mem_domain *domain = fault_domain_for_parts(parts);
    int domain_result;

    if (domain == NULL) {
        return NULL;
    }

    fault_results.worker_completed = false;
    fault_worker_context.results = &fault_results;
    fault_worker_context.worker = worker;
    k_sem_reset(&fault_worker_done);
    tid = k_thread_create(&fault_worker_thread, fault_worker_stack,
                          K_THREAD_STACK_SIZEOF(fault_worker_stack),
                          fault_worker_trampoline, &fault_worker_context, NULL,
                          NULL, FAULT_WORKER_PRIORITY, K_USER, K_FOREVER);
    zassert_not_null(tid, "user fault worker creation failed");

    domain_result = k_mem_domain_add_thread(domain, tid);
    if (domain_result != 0) {
        k_thread_abort(tid);
        zassert_equal(domain_result, 0,
                      "adding fault worker to memory domain failed");
        return NULL;
    }

    if (!fault_sync_pool_prepared) {
        int prepare_result;

        fault_sync_pool_prepare_count++;
        prepare_result = wamr_zephyr_sync_pool_prepare(&fault_sync, tid);
        if (prepare_result != 0) {
            k_thread_abort(tid);
            zassert_equal(prepare_result, 0,
                          "WAMR sync pool preparation failed");
            return NULL;
        }
        fault_sync_pool_prepared = true;
    }
    fault_worker_grant_sync_pool(tid);
    k_object_access_grant(&fault_worker_done, tid);
    return tid;
}

static void
fault_worker_wait(k_tid_t tid, const char *completion_message)
{
    int completion_result;
    int join_result;

    k_thread_start(tid);
    completion_result = k_sem_take(&fault_worker_done, FAULT_WORKER_TIMEOUT);
    join_result = k_thread_join(tid, FAULT_WORKER_TIMEOUT);
    if (join_result != 0) {
        k_thread_abort(tid);
    }

    zassert_equal(completion_result, 0, "%s", completion_message);
    zassert_equal(join_result, 0,
                  "user fault worker did not join within the bound");
    zassert_true(fault_results.worker_was_user,
                 "fault worker did not execute in user mode");
}

static void
recovery_worker(struct wamr_fault_results *results)
{
    results->value = 0U;
    results->recovery_completed = wamr_fault_run_add(&results->value);
}

void *
wamr_fault_suite_setup(void)
{
    int domain_result;

    fault_fixture.results = &fault_results;
    fault_sync_pool_prepared = false;
    fault_sync_pool_prepare_count = 0U;
    k_sem_init(&fault_worker_done, 0, 1);

    domain_result = k_mem_domain_init(
        &wamr_fault_complete_domain, ARRAY_SIZE(wamr_fault_complete_partitions),
        wamr_fault_complete_partitions);
    zassert_equal(domain_result, 0,
                  "complete WAMR fault memory domain initialization failed");

    domain_result =
        k_mem_domain_init(&wamr_fault_complete_minus_pool_domain,
                          ARRAY_SIZE(wamr_fault_complete_minus_pool_partitions),
                          wamr_fault_complete_minus_pool_partitions);
    zassert_equal(domain_result, 0,
                  "complete-minus-pool memory domain initialization failed");

    domain_result = k_mem_domain_init(
        &wamr_fault_complete_minus_module_domain,
        ARRAY_SIZE(wamr_fault_complete_minus_module_partitions),
        wamr_fault_complete_minus_module_partitions);
    zassert_equal(domain_result, 0,
                  "complete-minus-module memory domain initialization failed");

    domain_result = k_mem_domain_init(
        &wamr_fault_complete_minus_wamr_globals_domain,
        ARRAY_SIZE(wamr_fault_complete_minus_wamr_globals_partitions),
        wamr_fault_complete_minus_wamr_globals_partitions);
    zassert_equal(
        domain_result, 0,
        "complete-minus-WAMR-globals memory domain initialization failed");

    return &fault_fixture;
}

void
wamr_fault_before(void *fixture)
{
    struct wamr_usermode_faults_fixture *suite_fixture = fixture;

    expected_fault_disarm();
    memset(suite_fixture->results, 0, sizeof(*suite_fixture->results));
    memcpy(mutable_module, wasm_add, sizeof(mutable_module));
    k_sem_reset(&fault_worker_done);
}

void
wamr_fault_after(void *fixture)
{
    ARG_UNUSED(fixture);
    expected_fault_disarm();
}

void
wamr_fault_run_expected(enum wamr_fault_domain_parts parts,
                        wamr_fault_worker_t worker)
{
    k_tid_t tid = fault_worker_create(parts, worker);
    struct expected_fault_snapshot snapshot;

    if (tid == NULL) {
        return;
    }

    expected_fault_arm(tid, K_ERR_CPU_EXCEPTION, &fault_worker_done);
    fault_worker_wait(tid, "fault handler did not signal completion");
    snapshot = expected_fault_snapshot();
    expected_fault_disarm();

    zassert_true(snapshot.observed,
                 "worker returned without the expected fault");
    zassert_false(fault_results.worker_completed,
                  "faulting worker returned normally");
}

void
wamr_fault_run_normal(enum wamr_fault_domain_parts parts,
                      wamr_fault_worker_t worker)
{
    k_tid_t tid = fault_worker_create(parts, worker);

    if (tid == NULL) {
        return;
    }

    fault_worker_wait(tid, "user worker did not signal completion");
    zassert_true(fault_results.worker_completed,
                 "user worker did not complete normally");
}

bool
wamr_fault_run_add(uint32_t *result)
{
    char error[WAMR_TEST_ERROR_SIZE] = { 0 };

    return wamr_test_run_add_copy(
        &workflow_runtime, fault_pool, sizeof(fault_pool), wasm_add,
        sizeof(wasm_add), result, error, sizeof(error));
}

uint8_t *
wamr_fault_pool_buffer(void)
{
    return fault_pool;
}

uint8_t *
wamr_fault_module_buffer(void)
{
    return mutable_module;
}

void
wamr_fault_assert_recovery(struct wamr_fault_results *results)
{
    results->recovery_completed = false;
    results->value = 0U;
    wamr_fault_run_normal(WAMR_FAULT_COMPLETE_DOMAIN, recovery_worker);
    zassert_true(results->recovery_completed,
                 "valid WAMR workflow failed after the accepted fault");
    zassert_equal(results->value, 42U, "recovery WAMR workflow returned %u",
                  results->value);
    zassert_equal(fault_sync_pool_prepare_count, 1U,
                  "WAMR sync pool prepared %u times in one boot",
                  fault_sync_pool_prepare_count);
}
```

## src/fault_fixture.h
```c
/*
 * Copyright (C) 2026 Intel Corporation.  All rights reserved.
 * SPDX-License-Identifier: Apache-2.0 WITH LLVM-exception
 */

#ifndef WAMR_ZEPHYR_TEST_FAULT_FIXTURE_H
#define WAMR_ZEPHYR_TEST_FAULT_FIXTURE_H

#include <stdbool.h>
#include <stdint.h>

#include <zephyr/kernel.h>

#include "runtime_user_workflow.h"

enum wamr_fault_domain_parts {
    WAMR_FAULT_PART_WAMR = BIT(0),
    WAMR_FAULT_PART_POOL = BIT(1),
    WAMR_FAULT_PART_MODULE = BIT(2),
    WAMR_FAULT_PART_RESULTS = BIT(3),
    WAMR_FAULT_PART_LIBC = BIT(4),
};

#define WAMR_FAULT_COMPLETE_DOMAIN                                        \
    (WAMR_FAULT_PART_WAMR | WAMR_FAULT_PART_POOL | WAMR_FAULT_PART_MODULE \
     | WAMR_FAULT_PART_RESULTS | WAMR_FAULT_PART_LIBC)

struct wamr_fault_results {
    bool worker_was_user;
    bool worker_completed;
    bool workflow_completed;
    bool recovery_completed;
    bool runtime_trap_observed;
    bool runtime_initialized;
    uint32_t value;
    char exception[WAMR_TEST_ERROR_SIZE];
};

struct wamr_usermode_faults_fixture {
    struct wamr_fault_results *results;
};

typedef void (*wamr_fault_worker_t)(struct wamr_fault_results *results);

void *
wamr_fault_suite_setup(void);
void
wamr_fault_before(void *fixture);
void
wamr_fault_after(void *fixture);
void
wamr_fault_run_expected(enum wamr_fault_domain_parts parts,
                        wamr_fault_worker_t worker);
void
wamr_fault_run_normal(enum wamr_fault_domain_parts parts,
                      wamr_fault_worker_t worker);
bool
wamr_fault_run_add(uint32_t *result);
uint8_t *
wamr_fault_pool_buffer(void);
uint8_t *
wamr_fault_module_buffer(void);
void
wamr_fault_assert_recovery(struct wamr_fault_results *results);

#endif /* WAMR_ZEPHYR_TEST_FAULT_FIXTURE_H */
```

## src/test_guest_boundaries.c
```c
/*
 * Copyright (C) 2026 Intel Corporation.  All rights reserved.
 * SPDX-License-Identifier: Apache-2.0 WITH LLVM-exception
 */

#include <string.h>

#include <zephyr/ztest.h>

#include "expected_fault.h"
#include "fault_fixture.h"
#include "wasm_fixtures.h"

static void
wasm_oob_worker(struct wamr_fault_results *results)
{
    struct wamr_test_runtime runtime = { 0 };
    char error[WAMR_TEST_ERROR_SIZE] = { 0 };
    wasm_function_inst_t oob = NULL;
    uint32_t unused_argv[1] = { 0U };
    bool call_succeeded = false;
    const char *exception = NULL;
    bool started = wamr_test_runtime_start_copy_with_heap(
        &runtime, wamr_fault_pool_buffer(), WAMR_TEST_RUNTIME_POOL_SIZE,
        wasm_oob, sizeof(wasm_oob), 0U, error, sizeof(error));

    if (started) {
        oob = wasm_runtime_lookup_function(runtime.instance, "oob");
        if (oob != NULL) {
            call_succeeded =
                wasm_runtime_call_wasm(runtime.exec_env, oob, 0U, unused_argv);
        }
        exception = wasm_runtime_get_exception(runtime.instance);
        if (exception != NULL) {
            strncpy(results->exception, exception,
                    sizeof(results->exception) - 1U);
        }
        results->runtime_trap_observed = !call_succeeded && exception != NULL;
        wamr_test_runtime_stop(&runtime);
    }

    results->workflow_completed = started;
}

#if defined(CONFIG_WAMR_TEST_USERMODE_FAULT_WASM_OOB)
ZTEST_F(wamr_usermode_faults, test_wasm_oob_is_runtime_trap_not_mpu_fault)
{
    struct expected_fault_snapshot snapshot;

    wamr_fault_run_normal(WAMR_FAULT_COMPLETE_DOMAIN, wasm_oob_worker);
    snapshot = expected_fault_snapshot();

    zassert_true(fixture->results->workflow_completed,
                 "linear-memory OOB workflow did not start");
    zassert_true(fixture->results->runtime_trap_observed,
                 "linear-memory OOB did not produce a WAMR runtime trap");
    zassert_not_equal(fixture->results->exception[0], '\0',
                      "linear-memory OOB runtime exception was empty");
    zassert_not_null(
        strstr(fixture->results->exception, "out of bounds memory access"),
        "linear-memory OOB returned an unexpected exception: %s",
        fixture->results->exception);
    zassert_false(snapshot.observed,
                  "linear-memory OOB was accepted as an MPU fault");
    wamr_fault_assert_recovery(fixture->results);
}
#endif
```

## src/test_harness.c
```c
/*
 * Copyright (C) 2026 Intel Corporation.  All rights reserved.
 * SPDX-License-Identifier: Apache-2.0 WITH LLVM-exception
 */

#include <stdint.h>

#include <zephyr/ztest.h>

#include "fault_fixture.h"

static volatile uint32_t supervisor_runtime_result;

static void
publish_wamr_result_worker(struct wamr_fault_results *results)
{
    uint32_t value = 0U;

    if (!wamr_fault_run_add(&value) || value != 42U) {
        return;
    }

    results->workflow_completed = true;
    supervisor_runtime_result = value;
}

ZTEST_SUITE(wamr_usermode_faults, NULL, wamr_fault_suite_setup,
            wamr_fault_before, wamr_fault_after, NULL);

#if defined(CONFIG_WAMR_TEST_USERMODE_FAULT_SUPERVISOR_RUNTIME_STATE)
ZTEST_F(wamr_usermode_faults, test_user_cannot_access_supervisor_runtime_state)
{
    supervisor_runtime_result = 0U;

    wamr_fault_run_expected(WAMR_FAULT_COMPLETE_DOMAIN,
                            publish_wamr_result_worker);

    zassert_true(fixture->results->workflow_completed,
                 "WAMR add workflow did not complete before the fault");
    zassert_equal(supervisor_runtime_result, 0U,
                  "user worker published into supervisor runtime state");
    wamr_fault_assert_recovery(fixture->results);
}
#endif
```

## src/test_wamr_domain.c
```c
/*
 * Copyright (C) 2026 Intel Corporation.  All rights reserved.
 * SPDX-License-Identifier: Apache-2.0 WITH LLVM-exception
 */

#include <zephyr/ztest.h>

#include "fault_fixture.h"
#include "wasm_fixtures.h"

static bool
fault_runtime_init(struct wamr_fault_results *results)
{
    RuntimeInitArgs args = { 0 };

    args.mem_alloc_type = Alloc_With_Pool;
    args.mem_alloc_option.pool.heap_buf = wamr_fault_pool_buffer();
    args.mem_alloc_option.pool.heap_size = WAMR_TEST_RUNTIME_POOL_SIZE;
    args.running_mode = Mode_Interp;
    results->runtime_initialized = wasm_runtime_full_init(&args);
    return results->runtime_initialized;
}

static void
fault_runtime_cleanup(struct wamr_fault_results *results)
{
    if (results->runtime_initialized) {
        wasm_runtime_destroy();
        results->runtime_initialized = false;
    }
}

static void
full_init_worker(struct wamr_fault_results *results)
{
    if (fault_runtime_init(results)) {
        fault_runtime_cleanup(results);
    }
}

static void
load_module_worker(struct wamr_fault_results *results)
{
    wasm_module_t module;

    if (!fault_runtime_init(results)) {
        return;
    }

    module = wasm_runtime_load(wamr_fault_module_buffer(), sizeof(wasm_add),
                               results->exception, sizeof(results->exception));
    if (module != NULL) {
        wasm_runtime_unload(module);
    }
    fault_runtime_cleanup(results);
}

#if defined(CONFIG_WAMR_TEST_USERMODE_FAULT_POOL_PARTITION)
ZTEST_F(wamr_usermode_faults, test_wamr_pool_partition_is_required)
{
    bool initialized;

    wamr_fault_run_expected(WAMR_FAULT_COMPLETE_DOMAIN & ~WAMR_FAULT_PART_POOL,
                            full_init_worker);

    initialized = fixture->results->runtime_initialized;
    fault_runtime_cleanup(fixture->results);
    zassert_false(initialized,
                  "pool fault occurred after WAMR initialization completed");
    wamr_fault_assert_recovery(fixture->results);
}
#endif

#if defined(CONFIG_WAMR_TEST_USERMODE_FAULT_MODULE_PARTITION)
ZTEST_F(wamr_usermode_faults, test_writable_module_partition_is_required)
{
    wamr_fault_run_expected(WAMR_FAULT_COMPLETE_DOMAIN
                                & ~WAMR_FAULT_PART_MODULE,
                            load_module_worker);

    zassert_true(fixture->results->runtime_initialized,
                 "loader fault occurred before WAMR initialization completed");
    fault_runtime_cleanup(fixture->results);
    wamr_fault_assert_recovery(fixture->results);
}
#endif

#if defined(CONFIG_WAMR_TEST_USERMODE_FAULT_WAMR_GLOBALS_PARTITION)
ZTEST_F(wamr_usermode_faults, test_wamr_globals_partition_is_required)
{
    bool initialized;

    wamr_fault_run_expected(WAMR_FAULT_COMPLETE_DOMAIN & ~WAMR_FAULT_PART_WAMR,
                            full_init_worker);

    initialized = fixture->results->runtime_initialized;
    fault_runtime_cleanup(fixture->results);
    zassert_false(
        initialized,
        "WAMR-global fault occurred after WAMR initialization completed");
    wamr_fault_assert_recovery(fixture->results);
}
#endif
```
