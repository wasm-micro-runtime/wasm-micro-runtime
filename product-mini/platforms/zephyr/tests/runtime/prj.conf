## CMakeLists.txt
```
# Copyright (C) 2026 Intel Corporation.  All rights reserved.
# SPDX-License-Identifier: Apache-2.0 WITH LLVM-exception

cmake_minimum_required(VERSION 3.20.0)

find_package(Zephyr REQUIRED HINTS $ENV{ZEPHYR_BASE})
project(wamr_runtime_tests)

target_include_directories(app PRIVATE src ../common)
target_sources(app PRIVATE ../common/runtime_user_workflow.c)

if(CONFIG_WAMR_TEST_USER_MODE)
  target_sources(app PRIVATE src/test_runtime_usermode.c)
else()
  target_sources(app PRIVATE src/test_runtime.c)
endif()
```

## Kconfig
```
# Copyright (C) 2026 Intel Corporation.  All rights reserved.
# SPDX-License-Identifier: Apache-2.0 WITH LLVM-exception

mainmenu "WAMR Zephyr runtime tests"

config WAMR_TEST_USER_MODE
    bool "Exercise WAMR from a user thread"
    default n

source "Kconfig.zephyr"
```

## prj.conf
```kconfig
# Copyright (C) 2026 Intel Corporation.  All rights reserved.
# SPDX-License-Identifier: Apache-2.0 WITH LLVM-exception

CONFIG_ZTEST=y
CONFIG_PRINTK=y
CONFIG_ASSERT=y
CONFIG_THREAD_RUNTIME_STATS=y
CONFIG_ZTEST_STACK_SIZE=8192

CONFIG_WAMR=y
CONFIG_WAMR_INTERP=y
CONFIG_WAMR_AOT=n
CONFIG_WAMR_LIBC_BUILTIN=y
CONFIG_WAMR_GLOBAL_HEAP_POOL=y
```

## src/expected_fault.c
```c
/*
 * Copyright (C) 2026 Intel Corporation.  All rights reserved.
 * SPDX-License-Identifier: Apache-2.0 WITH LLVM-exception
 */

#include <zephyr/fatal.h>
#include <zephyr/kernel.h>

#include "expected_fault.h"

static struct expected_fault_state expected_fault;

void
expected_fault_arm(k_tid_t tid, unsigned int reason, struct k_sem *done)
{
    expected_fault.armed = true;
    expected_fault.observed = false;
    expected_fault.expected_tid = tid;
    expected_fault.expected_reason = reason;
    expected_fault.done = done;
}

bool
expected_fault_observed(void)
{
    return expected_fault.observed;
}

void
expected_fault_disarm(void)
{
    expected_fault.armed = false;
    expected_fault.observed = false;
    expected_fault.expected_tid = NULL;
    expected_fault.expected_reason = 0U;
    expected_fault.done = NULL;
}

void
k_sys_fatal_error_handler(unsigned int reason, const struct arch_esf *esf)
{
    ARG_UNUSED(esf);

    if (reason == K_ERR_KERNEL_PANIC || !expected_fault.armed
        || k_current_get() != expected_fault.expected_tid
        || reason != expected_fault.expected_reason) {
        k_fatal_halt(reason);
    }

    expected_fault.observed = true;
    k_sem_give(expected_fault.done);
}
```

## src/expected_fault.h
```c
/*
 * Copyright (C) 2026 Intel Corporation.  All rights reserved.
 * SPDX-License-Identifier: Apache-2.0 WITH LLVM-exception
 */

#ifndef WAMR_ZEPHYR_TEST_EXPECTED_FAULT_H
#define WAMR_ZEPHYR_TEST_EXPECTED_FAULT_H

#include <stdbool.h>

#include <zephyr/kernel.h>

struct expected_fault_state {
    bool armed;
    bool observed;
    k_tid_t expected_tid;
    unsigned int expected_reason;
    struct k_sem *done;
};

void
expected_fault_arm(k_tid_t tid, unsigned int reason, struct k_sem *done);
bool
expected_fault_observed(void);
void
expected_fault_disarm(void);

#endif
```

## src/runtime_fixture.h
```c
/*
 * Copyright (C) 2026 Intel Corporation.  All rights reserved.
 * SPDX-License-Identifier: Apache-2.0 WITH LLVM-exception
 */

#ifndef WAMR_ZEPHYR_RUNTIME_FIXTURE_H
#define WAMR_ZEPHYR_RUNTIME_FIXTURE_H

#include <stdint.h>

#include <zephyr/toolchain.h>

#include "runtime_user_workflow.h"

#define RUNTIME_POOL_SIZE WAMR_TEST_RUNTIME_POOL_SIZE

struct loaded_runtime {
    uint8_t pool[RUNTIME_POOL_SIZE] __aligned(8);
    struct wamr_test_runtime runtime;
};

#endif /* WAMR_ZEPHYR_RUNTIME_FIXTURE_H */
```

## src/test_runtime.c
```c
/*
 * Copyright (C) 2026 Intel Corporation.  All rights reserved.
 * SPDX-License-Identifier: Apache-2.0 WITH LLVM-exception
 */

#include <zephyr/ztest.h>

#include "runtime_fixture.h"
#include "wasm_fixtures.h"

#define SMALL_POOL_SIZE 1024U

static struct loaded_runtime runtime_fixture;
static uint8_t small_pool[SMALL_POOL_SIZE] __aligned(8);

static bool
run_add_lifecycle(uint32_t *result)
{
    char error[WAMR_TEST_ERROR_SIZE] = { 0 };

    return wamr_test_run_add_copy(
        &runtime_fixture.runtime, runtime_fixture.pool,
        sizeof(runtime_fixture.pool), wasm_add, sizeof(wasm_add), result, error,
        sizeof(error));
}

ZTEST_SUITE(runtime_interpreter_pool, NULL, NULL, NULL, NULL, NULL);

ZTEST(runtime_interpreter_pool, test_initialize_and_destroy)
{
    struct wamr_test_runtime empty_runtime = { 0 };
    struct wamr_test_runtime failed_runtime = { 0 };
    uint8_t failed_pool[64] __aligned(8) = { 0 };
    bool failed_initialized;
    bool initialized;

    wamr_test_runtime_stop(&empty_runtime);
    zassert_false(empty_runtime.initialized,
                  "empty runtime acquired initialization state");

    failed_initialized = wamr_test_runtime_init(&failed_runtime, failed_pool,
                                                sizeof(failed_pool));
    wamr_test_runtime_stop(&failed_runtime);

    zassert_false(failed_initialized, "undersized pool initialized runtime");
    zassert_false(failed_runtime.initialized,
                  "failed init retained initialization state");

    initialized =
        wamr_test_runtime_init(&runtime_fixture.runtime, runtime_fixture.pool,
                               sizeof(runtime_fixture.pool));
    zassert_true(runtime_fixture.runtime.initialized,
                 "successful init did not retain initialization state");
    if (initialized) {
        wamr_test_runtime_stop(&runtime_fixture.runtime);
    }

    zassert_true(initialized, "interpreter pool initialization failed");
    zassert_false(runtime_fixture.runtime.initialized,
                  "runtime initialization state was not cleared");
}

ZTEST(runtime_interpreter_pool, test_load_and_instantiate_valid_module)
{
    char error[WAMR_TEST_ERROR_SIZE] = { 0 };
    bool started = wamr_test_runtime_start_copy(
        &runtime_fixture.runtime, runtime_fixture.pool,
        sizeof(runtime_fixture.pool), wasm_add, sizeof(wasm_add), error,
        sizeof(error));
    bool loaded = started && runtime_fixture.runtime.module != NULL;
    bool instantiated = started && runtime_fixture.runtime.instance != NULL;
    bool exec_env_created = started && runtime_fixture.runtime.exec_env != NULL;

    if (started) {
        wamr_test_runtime_stop(&runtime_fixture.runtime);
    }

    zassert_true(started, "valid module lifecycle failed: %s", error);
    zassert_true(loaded, "valid module was not loaded");
    zassert_true(instantiated, "valid module was not instantiated");
    zassert_true(exec_env_created, "execution environment was not created");
    zassert_is_null(runtime_fixture.runtime.module,
                    "module handle was not cleared");
    zassert_is_null(runtime_fixture.runtime.instance,
                    "instance handle was not cleared");
    zassert_is_null(runtime_fixture.runtime.exec_env,
                    "execution environment handle was not cleared");
}

ZTEST(runtime_interpreter_pool, test_add_export_returns_expected_result)
{
    uint32_t result = 0U;
    bool called = run_add_lifecycle(&result);

    zassert_true(called, "add export call failed");
    zassert_equal(result, 42U, "add export returned %u", result);
}

ZTEST(runtime_interpreter_pool, test_trap_sets_exception)
{
    char error[WAMR_TEST_ERROR_SIZE] = { 0 };
    uint32_t unused_argv[1] = { 0U };
    bool started = wamr_test_runtime_start_copy(
        &runtime_fixture.runtime, runtime_fixture.pool,
        sizeof(runtime_fixture.pool), wasm_trap, sizeof(wasm_trap), error,
        sizeof(error));
    wasm_function_inst_t trap = NULL;
    bool call_succeeded = false;
    bool exception_set = false;

    if (started) {
        trap = wasm_runtime_lookup_function(runtime_fixture.runtime.instance,
                                            "trap");
        if (trap != NULL) {
            call_succeeded = wasm_runtime_call_wasm(
                runtime_fixture.runtime.exec_env, trap, 0U, unused_argv);
            exception_set =
                wasm_runtime_get_exception(runtime_fixture.runtime.instance)
                != NULL;
        }
        wamr_test_runtime_stop(&runtime_fixture.runtime);
    }

    zassert_true(started, "trapping module lifecycle failed: %s", error);
    zassert_not_null(trap, "trap export was not found");
    zassert_false(call_succeeded, "unreachable instruction did not trap");
    zassert_true(exception_set, "trap did not set an exception");
}

ZTEST(runtime_interpreter_pool, test_complete_lifecycle_runs_twice)
{
    uint32_t first_result = 0U;
    uint32_t second_result = 0U;
    bool first = run_add_lifecycle(&first_result);
    bool second = run_add_lifecycle(&second_result);

    zassert_true(first, "first lifecycle failed");
    zassert_equal(first_result, 42U, "first lifecycle returned %u",
                  first_result);
    zassert_true(second, "second lifecycle failed");
    zassert_equal(second_result, 42U, "second lifecycle returned %u",
                  second_result);
}

ZTEST(runtime_interpreter_pool, test_malformed_module_has_diagnostic)
{
    char error[WAMR_TEST_ERROR_SIZE] = { 0 };
    bool started = wamr_test_runtime_start_copy(
        &runtime_fixture.runtime, runtime_fixture.pool,
        sizeof(runtime_fixture.pool), malformed_wasm, sizeof(malformed_wasm),
        error, sizeof(error));

    if (started) {
        wamr_test_runtime_stop(&runtime_fixture.runtime);
    }

    zassert_false(started, "malformed module was accepted");
    zassert_not_equal(error[0], '\0', "malformed module had no diagnostic");
}

ZTEST(runtime_interpreter_pool, test_missing_export_is_clean_failure)
{
    char error[WAMR_TEST_ERROR_SIZE] = { 0 };
    bool started = wamr_test_runtime_start_copy(
        &runtime_fixture.runtime, runtime_fixture.pool,
        sizeof(runtime_fixture.pool), wasm_add, sizeof(wasm_add), error,
        sizeof(error));
    wasm_function_inst_t missing = NULL;
    bool exception_set = false;

    if (started) {
        missing = wasm_runtime_lookup_function(runtime_fixture.runtime.instance,
                                               "missing");
        exception_set =
            wasm_runtime_get_exception(runtime_fixture.runtime.instance)
            != NULL;
        wamr_test_runtime_stop(&runtime_fixture.runtime);
    }

    zassert_true(started, "valid module lifecycle failed: %s", error);
    zassert_is_null(missing, "missing export was unexpectedly found");
    zassert_false(exception_set, "missing lookup set an unrelated exception");
}

ZTEST(runtime_interpreter_pool, test_small_pool_failure_does_not_poison_retry)
{
    struct wamr_test_runtime small_runtime = { 0 };
    char error[WAMR_TEST_ERROR_SIZE] = { 0 };
    bool small_initialized;
    bool small_failed;
    uint32_t retry_result = 0U;
    bool retry_succeeded;

    small_failed = !wamr_test_runtime_start_copy(
        &small_runtime, small_pool, sizeof(small_pool), wasm_add,
        sizeof(wasm_add), error, sizeof(error));
    small_initialized = small_failed && error[0] != '\0';
    if (!small_failed) {
        wamr_test_runtime_stop(&small_runtime);
    }

    retry_succeeded = run_add_lifecycle(&retry_result);

    zassert_true(small_initialized, "small pool initialization failed early");
    zassert_true(small_failed, "small pool unexpectedly instantiated module");
    zassert_true(retry_succeeded, "normal pool retry failed");
    zassert_equal(retry_result, 42U, "normal pool retry returned %u",
                  retry_result);
}
```

## src/test_runtime_usermode.c
```c
/*
 * Copyright (C) 2026 Intel Corporation.  All rights reserved.
 * SPDX-License-Identifier: Apache-2.0 WITH LLVM-exception
 */

#include <stdint.h>
#include <string.h>

#include <zephyr/app_memory/app_memdomain.h>
#include <zephyr/kernel.h>
#include <zephyr/ztest.h>

#include "runtime_fixture.h"
#include "wasm_fixtures.h"
#include "zephyr_sync_pool.h"

#define USER_WORKER_STACK_SIZE 8192U
#define USER_WORKER_PRIORITY 5
#define USER_WORKER_TIMEOUT K_SECONDS(1)
#define SMALL_POOL_SIZE 1024U
#define FIXTURE_ACCESS_TOKEN 0x57414d52U

struct runtime_user_mode_fixture {
    k_thread_entry_t worker_entry;
    bool worker_was_user;
    bool workflow_succeeded;
    bool negative_observed;
    bool diagnostic_present;
    bool small_pool_initialized;
    bool recovery_succeeded;
    uint32_t result;
    uint32_t run_count;
    uint32_t access_token;
    char diagnostic[WAMR_TEST_ERROR_SIZE];
};

extern struct k_mem_partition z_libc_partition;
extern struct k_mem_partition ztest_mem_partition;

K_APPMEM_PARTITION_DEFINE(wamr_partition);

static struct k_mem_domain wamr_domain;
static struct k_thread runtime_worker;
K_THREAD_STACK_DEFINE(runtime_worker_stack, USER_WORKER_STACK_SIZE);
static k_tid_t runtime_worker_tid;
static struct k_sem worker_command;
static struct k_sem worker_done;
WAMR_ZEPHYR_SYNC_POOL_DEFINE(runtime_sync, 16, 8);

K_APP_BMEM(wamr_partition) static struct loaded_runtime user_runtime;
K_APP_BMEM(wamr_partition)
static uint8_t small_pool[SMALL_POOL_SIZE] __aligned(8);
ZTEST_DMEM static struct runtime_user_mode_fixture user_results = { 0 };

static bool
run_add_lifecycle(uint32_t *result)
{
    char error[WAMR_TEST_ERROR_SIZE] = { 0 };

    return wamr_test_run_add_copy(
        &user_runtime.runtime, user_runtime.pool, sizeof(user_runtime.pool),
        wasm_add, sizeof(wasm_add), result, error, sizeof(error));
}

static void
complete_worker(struct runtime_user_mode_fixture *results)
{
    results->worker_was_user = k_is_user_context();
    k_sem_give(&worker_done);
}

static void
valid_worker(void *arg1, void *arg2, void *arg3)
{
    struct runtime_user_mode_fixture *results = arg1;

    ARG_UNUSED(arg2);
    ARG_UNUSED(arg3);
    results->workflow_succeeded = run_add_lifecycle(&results->result);
    complete_worker(results);
}

static void
valid_recovery_worker(void *arg1, void *arg2, void *arg3)
{
    struct runtime_user_mode_fixture *results = arg1;
    uint32_t result = 0U;

    ARG_UNUSED(arg2);
    ARG_UNUSED(arg3);
    results->recovery_succeeded = run_add_lifecycle(&result) && result == 42U;
    complete_worker(results);
}

static void
twice_worker(void *arg1, void *arg2, void *arg3)
{
    struct runtime_user_mode_fixture *results = arg1;
    uint32_t result = 0U;

    ARG_UNUSED(arg2);
    ARG_UNUSED(arg3);
    if (run_add_lifecycle(&result) && result == 42U) {
        results->run_count++;
    }
    result = 0U;
    if (run_add_lifecycle(&result) && result == 42U) {
        results->run_count++;
    }
    results->workflow_succeeded = results->run_count == 2U;
    complete_worker(results);
}

static void
fixture_access_worker(void *arg1, void *arg2, void *arg3)
{
    struct runtime_user_mode_fixture *results = arg1;

    ARG_UNUSED(arg2);
    ARG_UNUSED(arg3);
    results->access_token = FIXTURE_ACCESS_TOKEN;
    complete_worker(results);
}

static void
malformed_worker(void *arg1, void *arg2, void *arg3)
{
    struct runtime_user_mode_fixture *results = arg1;
    char error[WAMR_TEST_ERROR_SIZE] = { 0 };
    bool started = wamr_test_runtime_start_copy(
        &user_runtime.runtime, user_runtime.pool, sizeof(user_runtime.pool),
        malformed_wasm, sizeof(malformed_wasm), error, sizeof(error));

    ARG_UNUSED(arg2);
    ARG_UNUSED(arg3);
    if (started) {
        wamr_test_runtime_stop(&user_runtime.runtime);
    }
    results->negative_observed = !started;
    results->diagnostic_present = error[0] != '\0';
    memcpy(results->diagnostic, error, sizeof(results->diagnostic));
    complete_worker(results);
}

static void
small_pool_worker(void *arg1, void *arg2, void *arg3)
{
    struct runtime_user_mode_fixture *results = arg1;
    struct wamr_test_runtime small_runtime = { 0 };
    char error[WAMR_TEST_ERROR_SIZE] = { 0 };
    bool started;

    ARG_UNUSED(arg2);
    ARG_UNUSED(arg3);
    started = wamr_test_runtime_start_copy(
        &small_runtime, small_pool, sizeof(small_pool), wasm_add,
        sizeof(wasm_add), error, sizeof(error));
    results->negative_observed = !started;
    results->small_pool_initialized = !started && error[0] != '\0';
    if (started) {
        wamr_test_runtime_stop(&small_runtime);
    }
    memcpy(results->diagnostic, error, sizeof(results->diagnostic));
    results->diagnostic_present = error[0] != '\0';
    complete_worker(results);
}

static void
missing_export_worker(void *arg1, void *arg2, void *arg3)
{
    struct runtime_user_mode_fixture *results = arg1;
    char error[WAMR_TEST_ERROR_SIZE] = { 0 };
    wasm_function_inst_t missing = NULL;
    bool exception_set = false;
    bool started = wamr_test_runtime_start_copy(
        &user_runtime.runtime, user_runtime.pool, sizeof(user_runtime.pool),
        wasm_add, sizeof(wasm_add), error, sizeof(error));

    ARG_UNUSED(arg2);
    ARG_UNUSED(arg3);
    if (started) {
        missing = wasm_runtime_lookup_function(user_runtime.runtime.instance,
                                               "missing");
        exception_set =
            wasm_runtime_get_exception(user_runtime.runtime.instance) != NULL;
        wamr_test_runtime_stop(&user_runtime.runtime);
    }
    results->negative_observed = started && missing == NULL && !exception_set;
    memcpy(results->diagnostic, error, sizeof(results->diagnostic));
    results->diagnostic_present = error[0] != '\0';
    complete_worker(results);
}

static void
runtime_user_worker(void *arg1, void *arg2, void *arg3)
{
    struct runtime_user_mode_fixture *results = arg1;

    ARG_UNUSED(arg2);
    ARG_UNUSED(arg3);
    while (true) {
        k_sem_take(&worker_command, K_FOREVER);
        if (results->worker_entry == NULL) {
            return;
        }
        results->worker_entry(results, NULL, NULL);
    }
}

static void
run_user_worker(struct runtime_user_mode_fixture *results,
                k_thread_entry_t entry)
{
    int completion_result;

    results->worker_entry = entry;
    k_sem_give(&worker_command);
    completion_result = k_sem_take(&worker_done, USER_WORKER_TIMEOUT);

    zassert_equal(completion_result, 0,
                  "user worker did not signal completion");
    zassert_true(results->worker_was_user,
                 "runtime worker did not execute in user mode");
}

static void *
runtime_user_mode_setup(void)
{
    struct k_mem_partition *partitions[] = {
        &wamr_partition,
        &z_libc_partition,
        &ztest_mem_partition,
    };

    zassert_equal(
        k_mem_domain_init(&wamr_domain, ARRAY_SIZE(partitions), partitions), 0,
        "WAMR memory domain initialization failed");
    k_sem_init(&worker_command, 0, 1);
    k_sem_init(&worker_done, 0, 1);
    runtime_worker_tid = k_thread_create(
        &runtime_worker, runtime_worker_stack,
        K_THREAD_STACK_SIZEOF(runtime_worker_stack), runtime_user_worker,
        &user_results, NULL, NULL, USER_WORKER_PRIORITY, K_USER, K_FOREVER);
    zassert_not_null(runtime_worker_tid, "user worker creation failed");
    zassert_equal(k_mem_domain_add_thread(&wamr_domain, runtime_worker_tid), 0,
                  "adding user worker to domain failed");
    zassert_equal(
        wamr_zephyr_sync_pool_prepare(&runtime_sync, runtime_worker_tid), 0,
        "WAMR sync pool preparation failed");
    k_object_access_grant(&worker_command, runtime_worker_tid);
    k_object_access_grant(&worker_done, runtime_worker_tid);
    k_thread_start(runtime_worker_tid);
    return &user_results;
}

static void
runtime_user_mode_before(void *fixture)
{
    memset(fixture, 0, sizeof(struct runtime_user_mode_fixture));
}

static void
runtime_user_mode_teardown(void *fixture)
{
    struct runtime_user_mode_fixture *results = fixture;
    int join_result;

    results->worker_entry = NULL;
    k_sem_give(&worker_command);
    join_result = k_thread_join(runtime_worker_tid, USER_WORKER_TIMEOUT);
    if (join_result != 0) {
        k_thread_abort(runtime_worker_tid);
    }
    zassert_equal(join_result, 0, "user worker did not join within the bound");
}

ZTEST_SUITE(runtime_user_mode, NULL, runtime_user_mode_setup,
            runtime_user_mode_before, NULL, runtime_user_mode_teardown);

ZTEST_F(runtime_user_mode, test_valid_module_workflow)
{
    run_user_worker(fixture, valid_worker);
    zassert_true(fixture->workflow_succeeded,
                 "valid user-mode workflow failed");
    zassert_equal(fixture->result, 42U, "valid user-mode workflow returned %u",
                  fixture->result);
}

ZTEST_F(runtime_user_mode, test_workflow_runs_twice)
{
    run_user_worker(fixture, twice_worker);
    zassert_true(fixture->workflow_succeeded,
                 "repeated user-mode workflow failed");
    zassert_equal(fixture->run_count, 2U,
                  "user-mode workflow completed %u times", fixture->run_count);
}

ZTEST_F(runtime_user_mode, test_fixture_memory_is_accessible)
{
    run_user_worker(fixture, fixture_access_worker);
    zassert_equal(fixture->access_token, FIXTURE_ACCESS_TOKEN,
                  "user worker could not update shared fixture memory");
}

ZTEST_F(runtime_user_mode, test_malformed_module_is_rejected)
{
    run_user_worker(fixture, malformed_worker);
    run_user_worker(fixture, valid_recovery_worker);
    zassert_true(fixture->negative_observed,
                 "malformed module was accepted in user mode");
    zassert_true(fixture->diagnostic_present,
                 "malformed module had no diagnostic");
    zassert_true(fixture->recovery_succeeded,
                 "valid workflow failed after malformed module");
}

ZTEST_F(runtime_user_mode, test_small_pool_fails_cleanly)
{
    run_user_worker(fixture, small_pool_worker);
    run_user_worker(fixture, valid_recovery_worker);
    zassert_true(fixture->small_pool_initialized,
                 "small pool initialization failed early");
    zassert_true(fixture->negative_observed,
                 "small pool unexpectedly instantiated module");
    zassert_true(fixture->recovery_succeeded,
                 "valid workflow failed after small pool rejection");
}

ZTEST_F(runtime_user_mode, test_missing_export_then_valid_workflow)
{
    run_user_worker(fixture, missing_export_worker);
    run_user_worker(fixture, valid_recovery_worker);
    zassert_true(fixture->negative_observed,
                 "missing export lookup did not fail cleanly");
    zassert_true(fixture->recovery_succeeded,
                 "valid workflow failed after missing export lookup");
}
```
