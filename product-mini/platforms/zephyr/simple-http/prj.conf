## CMakeLists.txt
```
# Copyright (C) 2019 Intel Corporation.  All rights reserved.
# SPDX-License-Identifier: Apache-2.0 WITH LLVM-exception

cmake_minimum_required(VERSION 3.14)

if(DEFINED ZEPHYR_BASE)
  set(ZEPHYR_VERSION_FILE "${ZEPHYR_BASE}/VERSION")
elseif(DEFINED ENV{ZEPHYR_BASE})
  set(ZEPHYR_VERSION_FILE "$ENV{ZEPHYR_BASE}/VERSION")
else()
  message(FATAL_ERROR "ZEPHYR_BASE is required to select the POSIX configuration")
endif()

if(NOT EXISTS "${ZEPHYR_VERSION_FILE}")
  message(FATAL_ERROR "Zephyr version file not found: ${ZEPHYR_VERSION_FILE}")
endif()

file(STRINGS "${ZEPHYR_VERSION_FILE}" ZEPHYR_VERSION_LINES
  REGEX "^VERSION_(MAJOR|MINOR) = [0-9]+$")
foreach(VERSION_LINE ${ZEPHYR_VERSION_LINES})
  if(VERSION_LINE MATCHES "^VERSION_MAJOR = ([0-9]+)$")
    set(ZEPHYR_VERSION_MAJOR "${CMAKE_MATCH_1}")
  elseif(VERSION_LINE MATCHES "^VERSION_MINOR = ([0-9]+)$")
    set(ZEPHYR_VERSION_MINOR "${CMAKE_MATCH_1}")
  endif()
endforeach()

if(NOT DEFINED ZEPHYR_VERSION_MAJOR OR NOT DEFINED ZEPHYR_VERSION_MINOR)
  message(FATAL_ERROR "Invalid Zephyr version file: ${ZEPHYR_VERSION_FILE}")
endif()

if(ZEPHYR_VERSION_MAJOR GREATER 4
   OR (ZEPHYR_VERSION_MAJOR EQUAL 4
       AND ZEPHYR_VERSION_MINOR GREATER_EQUAL 3))
  list(APPEND EXTRA_CONF_FILE
    "${CMAKE_CURRENT_SOURCE_DIR}/zephyr_4.3_plus.conf")
endif()

find_package(Zephyr REQUIRED HINTS $ENV{ZEPHYR_BASE})
project(wamr_simple_http)

# The runtime is built by the wasm-micro-runtime Zephyr module and configured
# through the CONFIG_WAMR_* options in prj.conf. The build target is derived
# from the board architecture, override it with -DWAMR_BUILD_TARGET=<target>.
target_sources(app PRIVATE src/main.c)

################  WebAssembly module  ################
# wasm-app/ is compiled with the wasi-sdk toolchain in a nested build, and the
# resulting http_get.wasm is turned into the byte array src/main.c embeds.
# The runtime is located through the Zephyr module system, never through a
# relative path reaching outside this directory.
set(WAMR_ROOT_DIR ${ZEPHYR_WASM_MICRO_RUNTIME_MODULE_DIR})
list(APPEND CMAKE_MODULE_PATH ${WAMR_ROOT_DIR}/build-scripts)
find_package(WASISDK REQUIRED)

include(ExternalProject)
ExternalProject_Add(wasm_app
  SOURCE_DIR        ${CMAKE_CURRENT_SOURCE_DIR}/wasm-app
  CONFIGURE_COMMAND ${CMAKE_COMMAND} -S ${CMAKE_CURRENT_SOURCE_DIR}/wasm-app -B build
                      -DCMAKE_TOOLCHAIN_FILE=${WASISDK_TOOLCHAIN}
                      -DWAMR_ROOT_DIR=${WAMR_ROOT_DIR}
  BUILD_COMMAND     ${CMAKE_COMMAND} --build build
  INSTALL_COMMAND   ${CMAKE_COMMAND} --install build --prefix ${CMAKE_CURRENT_BINARY_DIR}/wasm-app
  BUILD_ALWAYS      TRUE
)

set(WASM_HEADER ${CMAKE_CURRENT_BINARY_DIR}/generated/http_get.h)
add_custom_command(
  OUTPUT  ${WASM_HEADER}
  COMMAND ${CMAKE_COMMAND}
            -DINPUT=${CMAKE_CURRENT_BINARY_DIR}/wasm-app/http_get.wasm
            -DOUTPUT=${WASM_HEADER}
            -DSYMBOL=wasm_test_file
            -DALIGNED=4
            -P ${CMAKE_CURRENT_SOURCE_DIR}/../cmake/bin_to_header.cmake
  DEPENDS wasm_app
  COMMENT "Generating http_get.h from http_get.wasm"
  VERBATIM
)
add_custom_target(gen_http_get_h DEPENDS ${WASM_HEADER})

target_include_directories(app PRIVATE ${CMAKE_CURRENT_BINARY_DIR}/generated)
add_dependencies(app gen_http_get_h)
```

## sample.yaml
```
# Copyright (C) 2019 Intel Corporation.  All rights reserved.
# SPDX-License-Identifier: Apache-2.0 WITH LLVM-exception

sample:
  name: WAMR simple-http
  description: Use the WASI socket API from a WASM module

tests:
  sample.wamr.simple_http:
    tags: wamr
    # the request needs a reachable HTTP server on the host side, so the test
    # is not run automatically
    build_only: true
    platform_allow:
      - native_sim
    harness: console
    harness_config:
      type: one_line
      regex:
        - "PASS: the HTTP request completed"
```

## prj.conf
```kconfig
# Copyright (C) 2019 Intel Corporation.  All rights reserved.
# SPDX-License-Identifier: Apache-2.0 WITH LLVM-exception

# Log config
CONFIG_PRINTK=y
CONFIG_LOG=y
CONFIG_LOG_MODE_IMMEDIATE=y
CONFIG_NET_LOG=y

CONFIG_MAIN_STACK_SIZE=8192
CONFIG_HEAP_MEM_POOL_SIZE=32768
CONFIG_REQUIRES_FULL_LIBC=y

CONFIG_POSIX_TIMERS=y
CONFIG_POSIX_FD_MGMT=y

# Networking config
CONFIG_NETWORKING=y
CONFIG_NET_IPV4=y
CONFIG_NET_IPV6=y
CONFIG_NET_TCP=y
CONFIG_NET_SOCKETS=y
CONFIG_POSIX_API=n
CONFIG_PICOLIBC=y

# Stack conf
# CONFIG_NO_OPTIMIZATIONS=y
CONFIG_STACK_SENTINEL=y
CONFIG_HW_STACK_PROTECTION=y
# CONFIG_STACK_CANARIES=y
# CONFIG_ISR_STACK_SIZE=4096

# Network driver config
CONFIG_TEST_RANDOM_GENERATOR=y

# Network address config
CONFIG_NET_CONFIG_SETTINGS=y
CONFIG_NET_CONFIG_NEED_IPV4=y
CONFIG_NET_CONFIG_MY_IPV4_ADDR="192.0.2.1"
CONFIG_NET_CONFIG_PEER_IPV4_ADDR="192.0.2.2"
CONFIG_NET_CONFIG_MY_IPV4_GW="192.0.2.2"

# Config File System
CONFIG_FILE_SYSTEM=y
CONFIG_FILE_SYSTEM_LITTLEFS=y
# Flash
CONFIG_FLASH=y
CONFIG_FLASH_MAP=y

# CONFIG_DNS_RESOLVER=y
# CONFIG_DNS_SERVER_IP_ADDRESSES=y
# CONFIG_DNS_SERVER1="192.0.2.2"

# Config init stack
# CONFIG_INIT_STACKS=y 
# CONFIG_NET_PKT_RX_COUNT=100
# CONFIG_NET_PKT_TX_COUNT=100
# CONFIG_NET_BUF_RX_COUNT=100
# CONFIG_NET_BUF_TX_COUNT=100

# Flash
CONFIG_FLASH=y

# Debug
CONFIG_DEBUG=y

# WAMR runtime
CONFIG_WAMR=y
CONFIG_WAMR_INTERP=y
CONFIG_WAMR_AOT=n
CONFIG_WAMR_LIBC_BUILTIN=y
CONFIG_WAMR_LIBC_WASI=y
CONFIG_WAMR_REF_TYPES=y
CONFIG_WAMR_GLOBAL_HEAP_POOL=y
CONFIG_WAMR_GLOBAL_HEAP_SIZE=98304
```

## zephyr_4.3_plus.conf
```kconfig
# Copyright (C) 2026 Bytecode Alliance and/or its affiliates.
# SPDX-License-Identifier: Apache-2.0 WITH LLVM-exception

# Required by the fine-grained POSIX options starting with Zephyr 4.3.
CONFIG_POSIX_SYSTEM_INTERFACES=y
```

## src/main.c
```c
/*
 * Copyright (C) 2019 Intel Corporation.  All rights reserved.
 * SPDX-License-Identifier: Apache-2.0 WITH LLVM-exception
 */

// #include <autoconf.h>

#include <stdlib.h>
#include <string.h>
#include "bh_platform.h"
#include "bh_assert.h"
#include "bh_log.h"
#include "wasm_export.h"
#include "http_get.h"

#include <zephyr/kernel.h>
#include <zephyr/device.h>
#include <zephyr/devicetree.h>
#include <zephyr/net/net_ip.h>
#include <zephyr/net/socket.h>
#include <zephyr/net/http/client.h>

#define CONFIG_HEAP_MEM_POOL_SIZE WASM_GLOBAL_HEAP_SIZE
#define CONFIG_APP_STACK_SIZE 8192
#define CONFIG_APP_HEAP_SIZE 8192

/* Exit codes of the sample, see ../README.md */
#define EXIT_OK 0
#define EXIT_HOST 1
#define EXIT_WASM 2

static char global_heap_buf[CONFIG_HEAP_MEM_POOL_SIZE] = { 0 };

static int app_argc;
static char **app_argv;

int
main(void)
{
    int start, end;
    start = k_uptime_get_32();
    uint8 *wasm_file_buf = NULL;
    uint32 wasm_file_size;
    wasm_module_t wasm_module = NULL;
    wasm_module_inst_t wasm_module_inst = NULL;
    RuntimeInitArgs init_args;
    char error_buf[128];
    const char *exception;
    int rc;
    /* everything but a completed request is a failure */
    int ret = EXIT_HOST;

    int log_verbose_level = 2;

    memset(&init_args, 0, sizeof(RuntimeInitArgs));

#if WASM_ENABLE_GLOBAL_HEAP_POOL != 0
    init_args.mem_alloc_type = Alloc_With_Pool;
    init_args.mem_alloc_option.pool.heap_buf = global_heap_buf;
    init_args.mem_alloc_option.pool.heap_size = sizeof(global_heap_buf);
    printf("global heap size: %d\n", sizeof(global_heap_buf));
#else
#error "memory allocation scheme is not defined."
#endif

    /* initialize runtime environment */
    if (!wasm_runtime_full_init(&init_args)) {
        printf("ERROR: init runtime environment failed\n");
        return ret;
    }

    bh_log_set_verbose_level(log_verbose_level);

    /* load WASM byte buffer from byte buffer of include file */
    wasm_file_buf = (uint8 *)wasm_test_file;
    wasm_file_size = sizeof(wasm_test_file);
    printf("Wasm file size: %d\n", wasm_file_size);

    /* load WASM module */
    if (!(wasm_module = wasm_runtime_load(wasm_file_buf, wasm_file_size,
                                          error_buf, sizeof(error_buf)))) {
        printf("ERROR: failed to load module: %s\n", error_buf);
        goto fail1;
    }

    /* Set the WASI context */
#if WASM_ENABLE_LIBC_WASI != 0
#define ADDRESS_POOL_SIZE 1
    const char *addr_pool[ADDRESS_POOL_SIZE] = {
        "192.0.2.10/24",
    };
    /* No dir list => No file system
     * dir_cont = 0
     * No mapped dir list => No file system
     * map_dir_cont = 0
     * No environment variables
     * env_count = 0
     * No command line arguments
     * argv  0
     */
    wasm_runtime_set_wasi_args(wasm_module, NULL, 0, NULL, 0, NULL, 0, NULL, 0);
    wasm_runtime_set_wasi_addr_pool(wasm_module, addr_pool, ADDRESS_POOL_SIZE);
    wasm_runtime_set_wasi_ns_lookup_pool(wasm_module, NULL, 0);
#endif

    /* instantiate the module */
    if (!(wasm_module_inst = wasm_runtime_instantiate(
              wasm_module, CONFIG_APP_STACK_SIZE, CONFIG_APP_HEAP_SIZE,
              error_buf, sizeof(error_buf)))) {
        printf("ERROR: failed to instantiate module: %s\n", error_buf);
        goto fail2;
    }

    /* invoke the main function */
    if (!wasm_runtime_lookup_function(wasm_module_inst, "_start")
        && !wasm_runtime_lookup_function(wasm_module_inst,
                                         "__main_argc_argv")) {
        printf("ERROR: failed to lookup function main\n");
        goto fail3;
    }

    printf("main found\n");
    if (!wasm_application_execute_main(wasm_module_inst, 0, NULL)) {
        printf("ERROR: failed to execute main\n");
        ret = EXIT_WASM;
        goto fail3;
    }
    printf("main executed\n");

    if ((exception = wasm_runtime_get_exception(wasm_module_inst))) {
        printf("ERROR: exception: %s\n", exception);
        ret = EXIT_WASM;
        goto fail3;
    }

    /* The module reports what went wrong through its exit code, see
       wasm-apps/http_get.c: 0 means the request completed. */
    rc = wasm_runtime_get_wasi_exit_code(wasm_module_inst);
    printf("wasi exit code: %d\n", rc);
    if (rc != 0) {
        printf("ERROR: the HTTP request reported code %d\n", rc);
        ret = EXIT_WASM;
        goto fail3;
    }

    printf("PASS: the HTTP request completed\n");
    ret = EXIT_OK;

fail3:
    /* destroy the module instance */
    wasm_runtime_deinstantiate(wasm_module_inst);

fail2:
    /* unload the module */
    wasm_runtime_unload(wasm_module);

fail1:
    /* destroy runtime environment */
    wasm_runtime_destroy();

    end = k_uptime_get_32();

    printf("elapsed: %dms\n", (end - start));

    return ret;
}
```
