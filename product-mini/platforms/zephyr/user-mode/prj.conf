## CMakeLists.txt
```
# Copyright (C) 2019 Intel Corporation.  All rights reserved.
# SPDX-License-Identifier: Apache-2.0 WITH LLVM-exception

cmake_minimum_required(VERSION 3.14)
find_package(Zephyr REQUIRED HINTS $ENV{ZEPHYR_BASE})

project(wamr_user_mode LANGUAGES C)

# The runtime is built by the wasm-micro-runtime Zephyr module and configured
# through the CONFIG_WAMR_* options in prj.conf. CONFIG_WAMR_USERSPACE_PARTITION
# places the globals of the runtime into wamr_partition, the globals of the
# files below are placed there by K_APP_BMEM()/K_APP_DMEM().
target_sources(app PRIVATE src/main.c src/wamr_lib.c)

# Option: register the partition by hand, the way it has to be done for a WAMR
# library that was built externally (e.g. copied from another build). The
# library is still built by the module, but CONFIG_WAMR_USERSPACE_PARTITION is
# left empty so that the module does not register it, and the partition is
# registered here via set_property() instead.
#
# Usage: west build ... -- -DWAMR_USE_PREBUILT_LIB=1 \
#                          -DCONFIG_WAMR_USERSPACE_PARTITION=\"\"
option(WAMR_USE_PREBUILT_LIB
       "Use pre-built library approach for app_smem partition registration" OFF)

if(WAMR_USE_PREBUILT_LIB)
  if(NOT "${CONFIG_WAMR_USERSPACE_PARTITION}" STREQUAL "")
    message(FATAL_ERROR "WAMR_USE_PREBUILT_LIB requires an empty "
            "CONFIG_WAMR_USERSPACE_PARTITION, the module would register the "
            "partition a second time")
  endif()

  # Manually replicate what zephyr_library_app_memory(wamr_partition) does:
  # tell gen_app_partitions.py to place this library's globals into wamr_partition.
  set_property(TARGET zephyr_property_target
               APPEND PROPERTY COMPILE_OPTIONS
               "-l" "libwamr.a" "wamr_partition")

  message(STATUS "WAMR: using pre-built library approach for partition registration")
endif()

include(../cmake/wasm_app.cmake)
```

## sample.yaml
```
# Copyright (C) 2019 Intel Corporation.  All rights reserved.
# SPDX-License-Identifier: Apache-2.0 WITH LLVM-exception

sample:
  name: WAMR user-mode
  description: Run the runtime inside a Zephyr user-mode thread

common:
  tags: wamr
  harness: console
  harness_config:
    type: one_line
    regex:
      - "PASS: the wasm module ran to completion in user mode"
  # CONFIG_USERSPACE is not implemented on the POSIX architecture
  platform_allow:
    - qemu_arc/qemu_arc_hs

tests:
  sample.wamr.user_mode: {}
  sample.wamr.user_mode.prebuilt:
    extra_args: WAMR_USE_PREBUILT_LIB=1
    extra_configs:
      - CONFIG_WAMR_USERSPACE_PARTITION=""
```

## prj.conf
```kconfig
# Copyright (C) 2019 Intel Corporation.  All rights reserved.
# SPDX-License-Identifier: Apache-2.0 WITH LLVM-exception

CONFIG_USERSPACE=y
CONFIG_STACK_SENTINEL=y
CONFIG_PRINTK=y
CONFIG_LOG=y
CONFIG_LOG_BUFFER_SIZE=8096
CONFIG_THREAD_RUNTIME_STATS=y

CONFIG_WAMR=y
CONFIG_WAMR_INTERP=y
CONFIG_WAMR_AOT=y
CONFIG_WAMR_LIBC_BUILTIN=y
CONFIG_WAMR_GLOBAL_HEAP_POOL=y
CONFIG_WAMR_GLOBAL_HEAP_SIZE=40960
CONFIG_WAMR_USERSPACE_PARTITION="wamr_partition"
```

## src/main.c
```c
/*
 * Copyright (C) 2019 Intel Corporation.  All rights reserved.
 * SPDX-License-Identifier: Apache-2.0 WITH LLVM-exception
 */

#include <stdio.h>

#include <zephyr/version.h>
#include <zephyr/app_memory/app_memdomain.h>

#include "platform_common.h"
#include "zephyr_sync_pool.h"

#define MAIN_THREAD_STACK_SIZE 2048
#define MAIN_THREAD_PRIORITY 5

static struct k_thread iwasm_user_mode_thread;
K_THREAD_STACK_DEFINE(iwasm_user_mode_thread_stack, MAIN_THREAD_STACK_SIZE);

extern struct k_mem_partition z_libc_partition;
K_APPMEM_PARTITION_DEFINE(wamr_partition);
/* Two EMS heap locks: WAMR's global pool and this instance's application heap.
 * No condition variables are used without threading features in this sample.
 * The macro also declares a separate management mutex, outside these slots.
 */
WAMR_ZEPHYR_SYNC_POOL_DEFINE(wamr_sync, 2, 0);

/* WAMR memory domain */
struct k_mem_domain wamr_domain;

/* Exit codes of the sample, see ./README.md */
#define EXIT_OK 0
#define EXIT_HOST 1

extern void
iwasm_main(void *arg1, void *arg2, void *arg3);

/* Set by the user-mode thread, see wamr_lib.c */
extern int iwasm_result;

/* Run the user-mode thread to completion and return its exit code. */
static int
iwasm_user_mode(void)
{
    struct k_mem_partition *wamr_domain_parts[] = { &wamr_partition,
                                                    &z_libc_partition };

    printk("wamr_partition start addr: %ld, size: %zu\n", wamr_partition.start,
           wamr_partition.size);

    /* Initialize the memory domain with single WAMR partition */
    if (k_mem_domain_init(&wamr_domain, 2, wamr_domain_parts) != 0) {
        printk("ERROR: failed to initialize memory domain\n");
        return EXIT_HOST;
    }

    k_tid_t tid =
        k_thread_create(&iwasm_user_mode_thread, iwasm_user_mode_thread_stack,
                        MAIN_THREAD_STACK_SIZE, iwasm_main, NULL, NULL, NULL,
                        MAIN_THREAD_PRIORITY, K_USER, K_FOREVER);

    if (!tid) {
        printk("ERROR: failed to create the user mode thread\n");
        return EXIT_HOST;
    }

    /* Grant WAMR memory domain access to user mode thread */
    if (k_mem_domain_add_thread(&wamr_domain, tid) != 0) {
        printk("ERROR: failed to add memory domain to thread\n");
        return EXIT_HOST;
    }

    if (wamr_zephyr_sync_pool_prepare(&wamr_sync, tid) != BHT_OK) {
        printk("ERROR: failed to prepare WAMR user sync pool\n");
        return EXIT_HOST;
    }

#if KERNEL_VERSION_NUMBER < 0x040000 /* version 4.0.0 */
    /* k_thread_start is a legacy API for compatibility. Modern Zephyr threads
     * are initialized in the "sleeping" state and do not need special handling
     * for "start".*/
    k_thread_start(tid);
#else
    /* wakes up thread from sleeping */
    k_wakeup(tid);
#endif

    k_thread_join(tid, K_FOREVER);
    return iwasm_result;
}

#if KERNEL_VERSION_NUMBER < 0x030400 /* version 3.4.0 */
void
main(void)
{
    iwasm_user_mode();
}
#else
int
main(void)
{
    return iwasm_user_mode();
}
#endif
```

## src/wamr_lib.c
```c
/*
 * Copyright (C) 2019 Intel Corporation.  All rights reserved.
 * SPDX-License-Identifier: Apache-2.0 WITH LLVM-exception
 */

#include <stdlib.h>
#include <string.h>
#include <zephyr/app_memory/app_memdomain.h>
#include "bh_platform.h"
#include "bh_assert.h"
#include "bh_log.h"
#include "bh_queue.h"
#include "wasm_export.h"
/* Generated at build time from ../wasm-app/main.c, see ../CMakeLists.txt.
 * The array is written to by the runtime while loading the module, so it has
 * to live in wamr_partition like the rest of the globals. The header declares
 * it as "unsigned char", which is how the partition attribute gets attached. */
#define unsigned K_APP_DMEM(wamr_partition) unsigned
#include "test_wasm.h"
#undef unsigned

#if defined(BUILD_TARGET_RISCV64_LP64) || defined(BUILD_TARGET_RISCV32_ILP32)
#define CONFIG_GLOBAL_HEAP_BUF_SIZE 5120
#define CONFIG_APP_STACK_SIZE 512
#define CONFIG_APP_HEAP_SIZE 512
#else /* else of BUILD_TARGET_RISCV64_LP64 || BUILD_TARGET_RISCV32_ILP32 */
#define CONFIG_GLOBAL_HEAP_BUF_SIZE WASM_GLOBAL_HEAP_SIZE
#define CONFIG_APP_STACK_SIZE 8192
#define CONFIG_APP_HEAP_SIZE 8192
#endif /* end of BUILD_TARGET_RISCV64_LP64 || BUILD_TARGET_RISCV32_ILP32 */

/* Exit codes of the sample, see ../README.md */
#define EXIT_OK 0
#define EXIT_HOST 1
#define EXIT_WASM 2

/* Result of the user-mode thread, read by main() once it has joined */
K_APP_DMEM(wamr_partition) int iwasm_result = EXIT_HOST;

/**
 * Look up the entry point of the module, call it and report what the module
 * returned.
 *
 * @param module_inst the WASM module instance
 *
 * @return EXIT_OK when the module ran to completion and returned 0,
 *         EXIT_WASM when it faulted or returned non-zero,
 *         EXIT_HOST when the runtime could not call it at all.
 */
static int
app_instance_main(wasm_module_inst_t module_inst)
{
    const char *exception;
    wasm_function_inst_t func;
    wasm_exec_env_t exec_env;
    uint32 argv[2] = { 0 };
    uint32 param_count, result_count;
    int module_ret;

    if (!(func = wasm_runtime_lookup_function(module_inst, "main"))
        && !(func =
                 wasm_runtime_lookup_function(module_inst, "__main_argc_argv"))
        && !(func = wasm_runtime_lookup_function(module_inst, "app_main"))) {
        os_printf("ERROR: failed to lookup function main or app_main\n");
        return EXIT_HOST;
    }

    if (!(exec_env = wasm_runtime_create_exec_env(module_inst,
                                                  CONFIG_APP_HEAP_SIZE))) {
        os_printf("ERROR: create exec env failed\n");
        return EXIT_HOST;
    }

    /* main() takes (argc, argv) and returns a status, app_main() takes and
       returns nothing; pass zeroed arguments either way */
    param_count = wasm_func_get_param_count(func, module_inst);
    result_count = wasm_func_get_result_count(func, module_inst);

    LOG_VERBOSE("Calling the module entry point\n");
    wasm_runtime_call_wasm(exec_env, func, param_count, argv);
    module_ret = result_count > 0 ? (int)argv[0] : 0;

    wasm_runtime_destroy_exec_env(exec_env);

    if ((exception = wasm_runtime_get_exception(module_inst))) {
        os_printf("ERROR: exception: %s\n", exception);
        return EXIT_WASM;
    }

    if (module_ret != 0) {
        os_printf("ERROR: the wasm module returned %d\n", module_ret);
        return EXIT_WASM;
    }

    return EXIT_OK;
}

#if WASM_ENABLE_GLOBAL_HEAP_POOL != 0
K_APP_BMEM(wamr_partition)
static char global_heap_buf[CONFIG_GLOBAL_HEAP_BUF_SIZE] = { 0 };
#endif

void
iwasm_main(void *arg1, void *arg2, void *arg3)
{
    int start, end;
    start = k_uptime_get_32();
    uint8 *wasm_file_buf = NULL;
    uint32 wasm_file_size;
    wasm_module_t wasm_module = NULL;
    wasm_module_inst_t wasm_module_inst = NULL;
    RuntimeInitArgs init_args;
    char error_buf[128];
#if WASM_ENABLE_LOG != 0
    int log_verbose_level = 2;
#endif

    (void)arg1;
    (void)arg2;
    (void)arg3;

    os_printf("User mode thread: start\n");

    memset(&init_args, 0, sizeof(RuntimeInitArgs));

#if WASM_ENABLE_GLOBAL_HEAP_POOL != 0
    init_args.mem_alloc_type = Alloc_With_Pool;
    init_args.mem_alloc_option.pool.heap_buf = global_heap_buf;
    init_args.mem_alloc_option.pool.heap_size = sizeof(global_heap_buf);
#elif (defined(CONFIG_COMMON_LIBC_MALLOC)            \
       && CONFIG_COMMON_LIBC_MALLOC_ARENA_SIZE != 0) \
    || defined(CONFIG_NEWLIB_LIBC)
    init_args.mem_alloc_type = Alloc_With_System_Allocator;
#else
#error "memory allocation scheme is not defined."
#endif

    /* initialize runtime environment */
    if (!wasm_runtime_full_init(&init_args)) {
        printf("ERROR: init runtime environment failed\n");
        return;
    }

    iwasm_result = EXIT_HOST;

#if WASM_ENABLE_LOG != 0
    bh_log_set_verbose_level(log_verbose_level);
#endif

    /* load WASM byte buffer from byte buffer of include file */
    wasm_file_buf = (uint8 *)wasm_test_file;
    wasm_file_size = sizeof(wasm_test_file);

    /* load WASM module */
    if (!(wasm_module = wasm_runtime_load(wasm_file_buf, wasm_file_size,
                                          error_buf, sizeof(error_buf)))) {
        printf("ERROR: %s\n", error_buf);
        goto fail1;
    }

    /* instantiate the module */
    if (!(wasm_module_inst = wasm_runtime_instantiate(
              wasm_module, CONFIG_APP_STACK_SIZE, CONFIG_APP_HEAP_SIZE,
              error_buf, sizeof(error_buf)))) {
        printf("ERROR: %s\n", error_buf);
        goto fail2;
    }

    /* invoke the main function */
    iwasm_result = app_instance_main(wasm_module_inst);
    if (iwasm_result == EXIT_OK)
        printf("PASS: the wasm module ran to completion in user mode\n");

    /* destroy the module instance */
    wasm_runtime_deinstantiate(wasm_module_inst);

fail2:
    /* unload the module */
    wasm_runtime_unload(wasm_module);

fail1:
    /* destroy runtime environment */
    wasm_runtime_destroy();

    end = k_uptime_get_32();

    os_printf("User mode thread: elapsed %d\n", (end - start));
}
```
