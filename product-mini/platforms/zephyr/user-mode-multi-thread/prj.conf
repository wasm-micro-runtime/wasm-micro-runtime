## CMakeLists.txt
```
# Copyright (C) 2026 Intel Corporation.  All rights reserved.
# SPDX-License-Identifier: Apache-2.0 WITH LLVM-exception

cmake_minimum_required(VERSION 3.20.0)

find_package(Zephyr REQUIRED HINTS $ENV{ZEPHYR_BASE})
project(wamr_user_mode_multi_thread LANGUAGES C)

# Apply native stack/atomic settings to both app and the runtime module.
zephyr_compile_definitions(WASM_UINT64_IS_ATOMIC=0
                           APP_THREAD_STACK_SIZE_DEFAULT=4096
                           APP_THREAD_STACK_SIZE_MIN=4096)

target_sources(app PRIVATE src/main.c src/wamr_runtime.c)
include(../cmake/wasm_app.cmake)
```

## sample.yaml
```
# Copyright (C) 2026 Intel Corporation.  All rights reserved.
# SPDX-License-Identifier: Apache-2.0 WITH LLVM-exception

sample:
  name: WAMR user-mode multi-thread
  description: Run guest pthread workers inside a Zephyr user-mode WAMR thread

common:
  tags: wamr
  harness: console
  harness_config:
    type: one_line
    regex:
      - "PASS: guest pthread workflow completed in Zephyr user mode"
  platform_allow:
    - qemu_arc/qemu_arc_hs

tests:
  sample.wamr.user_mode_multi_thread: {}
  sample.wamr.user_mode_multi_thread.failed_join:
    timeout: 15
    extra_args: WAMR_ZEPHYR_WASM_APP_SOURCE_DIR=tests/failed-join
```

## prj.conf
```kconfig
# Copyright (C) 2026 Intel Corporation.  All rights reserved.
# SPDX-License-Identifier: Apache-2.0 WITH LLVM-exception

CONFIG_USERSPACE=y
CONFIG_PRINTK=y

CONFIG_WAMR=y
CONFIG_WAMR_INTERP=y
CONFIG_WAMR_AOT=n
CONFIG_WAMR_LIBC_BUILTIN=y
CONFIG_WAMR_LIB_PTHREAD=y
CONFIG_WAMR_GLOBAL_HEAP_POOL=y
CONFIG_WAMR_GLOBAL_HEAP_SIZE=40960
CONFIG_WAMR_USERSPACE_PARTITION="wamr_partition"
```

## src/main.c
```c
/*
 * Copyright (C) 2026 Intel Corporation.  All rights reserved.
 * SPDX-License-Identifier: Apache-2.0 WITH LLVM-exception
 */

#include <zephyr/app_memory/app_memdomain.h>
#include <zephyr/kernel.h>
#include <zephyr/sys/util.h>

#include "zephyr_sync_pool.h"
#include "zephyr_thread_pool.h"

#define EXIT_HOST 1
#define WAMR_ROOT_PRIORITY 5

WAMR_ZEPHYR_THREAD_POOL_DEFINE(wamr_threads, 4, 4096);
WAMR_ZEPHYR_SYNC_POOL_DEFINE(wamr_sync, 16, 8);
K_APPMEM_PARTITION_DEFINE(wamr_partition);
K_THREAD_STACK_DEFINE(wamr_root_stack, 8192);

static struct k_thread wamr_root_thread;
static struct k_mem_domain wamr_domain;

extern struct k_mem_partition z_libc_partition;
extern int wamr_runtime_result;
extern void
wamr_runtime_main(void *, void *, void *);

/* After guest execution stops creating workers, confirm native termination
 * before its runtime resources are destroyed. These are application-owned
 * native objects, never opaque WAMR handles cast to k_tid_t.
 */
int
wamr_runtime_wait_workers(void)
{
    size_t i;

    for (i = 0; i < wamr_threads.thread_count; i++) {
        int result = k_thread_join(&wamr_threads.threads[i], K_FOREVER);

        if (result != 0) {
            return result;
        }
    }
    return 0;
}

int
main(void)
{
    struct k_mem_partition *parts[] = {
        &wamr_partition,
        &z_libc_partition,
    };
    k_tid_t root;

    printk("wamr_partition start addr: %ld, size: %zu\n", wamr_partition.start,
           wamr_partition.size);

    root = k_thread_create(&wamr_root_thread, wamr_root_stack,
                           K_THREAD_STACK_SIZEOF(wamr_root_stack),
                           wamr_runtime_main, NULL, NULL, NULL,
                           WAMR_ROOT_PRIORITY, K_USER, K_FOREVER);
    if (root == NULL) {
        printk("ERROR: failed to create suspended WAMR root thread\n");
        return EXIT_HOST;
    }

    if (k_mem_domain_init(&wamr_domain, ARRAY_SIZE(parts), parts) != 0) {
        printk("ERROR: failed to initialize WAMR memory domain\n");
        return EXIT_HOST;
    }

    if (k_mem_domain_add_thread(&wamr_domain, root) != 0) {
        printk("ERROR: failed to add WAMR root thread to memory domain\n");
        return EXIT_HOST;
    }

    if (wamr_zephyr_thread_pool_prepare(&wamr_threads, root) != BHT_OK) {
        printk("ERROR: failed to prepare WAMR user thread pool\n");
        return EXIT_HOST;
    }

    if (wamr_zephyr_sync_pool_prepare(&wamr_sync, root) != BHT_OK) {
        printk("ERROR: failed to prepare WAMR user sync pool\n");
        return EXIT_HOST;
    }

    wamr_runtime_result = EXIT_HOST;
    k_thread_start(root);
    if (k_thread_join(root, K_FOREVER) != 0) {
        printk("ERROR: failed to join WAMR root thread\n");
        return EXIT_HOST;
    }

    return wamr_runtime_result;
}
```

## src/wamr_runtime.c
```c
/*
 * Copyright (C) 2026 Intel Corporation.  All rights reserved.
 * SPDX-License-Identifier: Apache-2.0 WITH LLVM-exception
 */

#include <stdint.h>
#include <stdio.h>
#include <string.h>

#include <zephyr/kernel.h>
#include <zephyr/app_memory/app_memdomain.h>

#include "bh_platform.h"
#include "wasm_export.h"
/* app globals are not covered by the runtime module's partition registration.
 * Loading mutates these generated bytes, so place them in writable app memory.
 */
#define unsigned K_APP_DMEM(wamr_partition) unsigned
#include "test_wasm.h"
#undef unsigned

#define CONFIG_GLOBAL_HEAP_BUF_SIZE WASM_GLOBAL_HEAP_SIZE
#define CONFIG_APP_STACK_SIZE 4096
#define CONFIG_APP_HEAP_SIZE 8192

#define EXIT_OK 0
#define EXIT_HOST 1
#define EXIT_WASM 2

K_APP_DMEM(wamr_partition) int wamr_runtime_result = EXIT_HOST;

extern int
wamr_runtime_wait_workers(void);

#if WASM_ENABLE_GLOBAL_HEAP_POOL != 0
K_APP_BMEM(wamr_partition)
static char global_heap_buf[CONFIG_GLOBAL_HEAP_BUF_SIZE] = { 0 };
#endif

static int
run_guest_main(wasm_module_inst_t module_inst)
{
    uint32_t argv[2] = { 0 };
    uint32_t param_count;
    uint32_t result_count;
    int module_ret = 0;
    wasm_exec_env_t exec_env;
    wasm_function_inst_t func;
    const char *exception;

    func = wasm_runtime_lookup_function(module_inst, "main");
    if (func == NULL) {
        func = wasm_runtime_lookup_function(module_inst, "__main_argc_argv");
    }
    if (func == NULL) {
        printf("ERROR: failed to lookup guest main\n");
        return EXIT_HOST;
    }

    exec_env = wasm_runtime_create_exec_env(module_inst, CONFIG_APP_STACK_SIZE);
    if (exec_env == NULL) {
        printf("ERROR: failed to create guest exec env\n");
        return EXIT_HOST;
    }

    param_count = wasm_func_get_param_count(func, module_inst);
    result_count = wasm_func_get_result_count(func, module_inst);
    if (!wasm_runtime_call_wasm(exec_env, func, param_count, argv)) {
        wasm_runtime_destroy_exec_env(exec_env);
        exception = wasm_runtime_get_exception(module_inst);
        if (exception != NULL) {
            printf("ERROR: exception: %s\n", exception);
            return EXIT_WASM;
        }
        printf("ERROR: failed to invoke guest main\n");
        return EXIT_HOST;
    }

    if (result_count > 0U) {
        module_ret = (int)argv[0];
    }

    wasm_runtime_destroy_exec_env(exec_env);

    exception = wasm_runtime_get_exception(module_inst);
    if (exception != NULL) {
        printf("ERROR: exception: %s\n", exception);
        return EXIT_WASM;
    }

    if (module_ret != 0) {
        printf("ERROR: the wasm module returned %d\n", module_ret);
        return EXIT_WASM;
    }

    return EXIT_OK;
}

void
wamr_runtime_main(void *arg1, void *arg2, void *arg3)
{
    uint32_t wasm_file_size = sizeof(wasm_test_file);
    uint8_t *wasm_file_buf = (uint8_t *)wasm_test_file;
    wasm_module_t module = NULL;
    wasm_module_inst_t module_inst = NULL;
    RuntimeInitArgs init_args;
    char error_buf[128] = { 0 };
    int32_t start;
    int32_t end;

    ARG_UNUSED(arg1);
    ARG_UNUSED(arg2);
    ARG_UNUSED(arg3);

    start = k_uptime_get_32();
    os_printf("User mode thread: start\n");
    wamr_runtime_result = EXIT_HOST;

    memset(&init_args, 0, sizeof(init_args));
#if WASM_ENABLE_GLOBAL_HEAP_POOL != 0
    init_args.mem_alloc_type = Alloc_With_Pool;
    init_args.mem_alloc_option.pool.heap_buf = global_heap_buf;
    init_args.mem_alloc_option.pool.heap_size = sizeof(global_heap_buf);
#else
#error "Zephyr user-mode sample requires the global heap pool"
#endif

    if (!wasm_runtime_full_init(&init_args)) {
        printf("ERROR: init runtime environment failed\n");
        goto out;
    }

    module = wasm_runtime_load(wasm_file_buf, wasm_file_size, error_buf,
                               sizeof(error_buf));
    if (module == NULL) {
        printf("ERROR: %s\n", error_buf);
        goto destroy_runtime;
    }

    module_inst = wasm_runtime_instantiate(module, CONFIG_APP_STACK_SIZE,
                                           CONFIG_APP_HEAP_SIZE, error_buf,
                                           sizeof(error_buf));
    if (module_inst == NULL) {
        printf("ERROR: %s\n", error_buf);
        goto unload_module;
    }

    wamr_runtime_result = run_guest_main(module_inst);
    if (wamr_runtime_wait_workers() != 0) {
        printf("ERROR: failed to wait for native worker termination\n");
        wamr_runtime_result = EXIT_HOST;
        goto out;
    }

    wasm_runtime_deinstantiate(module_inst);

unload_module:
    wasm_runtime_unload(module);

destroy_runtime:
    wasm_runtime_destroy();
    if (wamr_runtime_result == EXIT_OK) {
        printf("PASS: guest pthread workflow completed in Zephyr user mode\n");
    }

out:
    end = k_uptime_get_32();
    os_printf("User mode thread: elapsed %d\n", (int)(end - start));
}
```
