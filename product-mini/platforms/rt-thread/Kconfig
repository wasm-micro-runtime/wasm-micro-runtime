## product-mini/platforms/rt-thread/Kconfig
```kconfig
# Copyright (C) 2026, RT-Thread Development Team
# SPDX-License-Identifier: Apache-2.0 WITH LLVM-exception

if PKG_USING_WAMR

config WAMR_RTT_BUILD_RUNNER
    bool "Build the optional WAMR buffer runner"
    depends on RT_USING_HEAP && RT_USING_MUTEX && RT_USING_SEMAPHORE
    default n
    help
        Provide a synchronous helper which executes a buffer in an RT worker.
        This is a product helper, not part of the required WAMR OSAL.
        It owns the global runtime lifecycle; do not use it concurrently with
        another embedder or the iwasm file command. Advanced feature profiles
        are experimental and require their own validation.

config WAMR_RTT_BUILD_IWASM
    bool "Build the legacy iwasm file command (experimental)"
    depends on RT_USING_POSIX_FS && RT_USING_FINSH
    default n
    help
        Build the DFS/FinSH entry point separately from vmcore and the buffer
        runner. This legacy entry and optional runtime features need dedicated
        validation; enabling the command does not certify their completeness.

endif
```

## product-mini/platforms/zephyr/tests/platform-api/testcase.yaml
```yaml
# Copyright (C) 2026 Intel Corporation.  All rights reserved.
# SPDX-License-Identifier: Apache-2.0 WITH LLVM-exception

common:
  tags: wamr ztest platform_api interpreter pool
  harness: ztest
tests:
  wamr.zephyr.platform_api.kernel:
    platform_allow:
      - native_sim
      - qemu_arc/qemu_arc_hs
  wamr.zephyr.platform_api.userspace:
    platform_allow:
      - qemu_arc/qemu_arc_hs
    extra_configs:
      - CONFIG_USERSPACE=y
      - CONFIG_WAMR_TEST_USER_MODE=y
```

## product-mini/platforms/zephyr/tests/runtime/testcase.yaml
```yaml
# Copyright (C) 2026 Intel Corporation.  All rights reserved.
# SPDX-License-Identifier: Apache-2.0 WITH LLVM-exception

common:
  tags: wamr ztest runtime interpreter pool
  harness: ztest
tests:
  wamr.zephyr.runtime.interpreter_pool:
    platform_allow:
      - native_sim
      - qemu_arc/qemu_arc_hs
    extra_configs:
      - CONFIG_WAMR=y
      - CONFIG_WAMR_INTERP=y
      - CONFIG_WAMR_AOT=n
      - CONFIG_WAMR_LIBC_BUILTIN=y
      - CONFIG_WAMR_GLOBAL_HEAP_POOL=y
      - CONFIG_WAMR_GLOBAL_HEAP_SIZE=131072
  wamr.zephyr.runtime.user_mode_interpreter_pool:
    platform_allow:
      - qemu_arc/qemu_arc_hs
    extra_configs:
      - CONFIG_USERSPACE=y
      - CONFIG_WAMR=n
      - CONFIG_WAMR_TEST_USER_MODE=y
```

## product-mini/platforms/zephyr/tests/thread-pool/testcase.yaml
```yaml
# Copyright (C) 2026 Intel Corporation.  All rights reserved.
# SPDX-License-Identifier: Apache-2.0 WITH LLVM-exception

common:
  tags: wamr ztest threads interpreter pool
  harness: ztest
tests:
  wamr.zephyr.thread_pool.kernel_contract:
    platform_allow:
      - native_sim
      - qemu_arc/qemu_arc_hs
    extra_configs:
      - CONFIG_USERSPACE=n
  wamr.zephyr.thread_pool.user_contract:
    platform_allow:
      - qemu_arc/qemu_arc_hs
    extra_configs:
      - CONFIG_USERSPACE=y
      - CONFIG_WAMR_USERSPACE_PARTITION="wamr_partition"
      - CONFIG_WAMR_TEST_USER_MODE=y
      - CONFIG_DYNAMIC_OBJECTS=n
  wamr.zephyr.thread_pool.user_transition:
    platform_allow:
      - qemu_arc/qemu_arc_hs
    extra_configs:
      - CONFIG_USERSPACE=y
      - CONFIG_WAMR_USERSPACE_PARTITION="wamr_partition"
      - CONFIG_WAMR_TEST_USER_MODE=y
      - CONFIG_WAMR_TEST_THREAD_POOL_TRANSITION=y
      - CONFIG_DYNAMIC_OBJECTS=n
```

## product-mini/platforms/zephyr/tests/usermode-faults/testcase.yaml
```yaml
# Copyright (C) 2026 Intel Corporation.  All rights reserved.
# SPDX-License-Identifier: Apache-2.0 WITH LLVM-exception

common:
  tags: wamr ztest runtime interpreter pool userspace fault
  harness: ztest
  platform_allow:
    - qemu_arc/qemu_arc_hs
  extra_configs:
    - CONFIG_USERSPACE=y
    - CONFIG_WAMR=n
    - CONFIG_WAMR_TEST_USERMODE_FAULTS=y

tests:
  wamr.zephyr.usermode_faults.supervisor_runtime_state:
    extra_configs:
      - CONFIG_WAMR_TEST_USERMODE_FAULT_SUPERVISOR_RUNTIME_STATE=y
  wamr.zephyr.usermode_faults.pool_partition:
    extra_configs:
      - CONFIG_WAMR_TEST_USERMODE_FAULT_POOL_PARTITION=y
  wamr.zephyr.usermode_faults.module_partition:
    extra_configs:
      - CONFIG_WAMR_TEST_USERMODE_FAULT_MODULE_PARTITION=y
  wamr.zephyr.usermode_faults.wamr_globals_partition:
    extra_configs:
      - CONFIG_WAMR_TEST_USERMODE_FAULT_WAMR_GLOBALS_PARTITION=y
  wamr.zephyr.usermode_faults.wasm_oob:
    extra_configs:
      - CONFIG_WAMR_TEST_USERMODE_FAULT_WASM_OOB=y
```

## zephyr/Kconfig
```kconfig
# Copyright (C) 2019 Intel Corporation.  All rights reserved.
# SPDX-License-Identifier: Apache-2.0 WITH LLVM-exception

menuconfig WAMR
	bool "WebAssembly Micro Runtime (WAMR)"
	help
	  Build the WebAssembly Micro Runtime into the application image.
	  The runtime is compiled as a Zephyr library; the build target is
	  derived from the board architecture unless WAMR_BUILD_TARGET is
	  passed explicitly on the CMake command line.

if WAMR

config WAMR_INTERP
	bool "Interpreter"
	default y
	help
	  Enable the WebAssembly bytecode interpreter.

config WAMR_FAST_INTERP
	bool "Fast interpreter"
	depends on WAMR_INTERP
	help
	  Use the fast interpreter. It runs faster but consumes more memory
	  for the pre-compiled bytecode.

config WAMR_AOT
	bool "AOT"
	default y
	help
	  Enable running AOT modules compiled by wamrc.

config WAMR_LIBC_BUILTIN
	bool "Built-in libc"
	default y
	help
	  Provide a minimal built-in libc (printf and friends) to WASM modules.

config WAMR_LIBC_WASI
	bool "WASI libc"
	help
	  Provide the WASI libc to WASM modules. Requires file system and
	  socket support on the platform.

config WAMR_LIB_PTHREAD
	bool "pthread library"
	help
	  Provide the pthread library to WASM modules.

config WAMR_REF_TYPES
	bool "Reference types"
	help
	  Support the reference types proposal (externref, funcref). Modules
	  built with a recent wasi-sdk need this even when they do not use
	  reference types themselves.

config WAMR_GLOBAL_HEAP_POOL
	bool "Global heap pool"
	default y
	help
	  Allocate the runtime memory from a statically reserved pool instead
	  of the system allocator. Recommended on memory constrained devices.

config WAMR_GLOBAL_HEAP_SIZE
	int "Global heap pool size (bytes)"
	depends on WAMR_GLOBAL_HEAP_POOL
	default 131072
	help
	  Size in bytes of the statically reserved runtime memory pool.

endif # WAMR
```
